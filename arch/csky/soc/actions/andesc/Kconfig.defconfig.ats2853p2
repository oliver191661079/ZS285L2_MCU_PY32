## drivers/flash/Kconfig.acts
```kconfig
# Kconfig - SPI NOR controller driver configuration options
#
# Copyright (c) 2017 Actions Semiconductor Co., Ltd
#
# SPDX-License-Identifier: Apache-2.0
#

if FLASH && SOC_FAMILY_ACTS

menuconfig XSPI_NOR_ACTS
	bool "XIP SPI NOR flash driver for Actions SoC"
	depends on SOC_FAMILY_ACTS && FLASH
	default n
	help
	 Enable Actions SoC XIP SPI NOR flash driver.

config XSPI_NOR_ACTS
	bool "SPI NOR ram driver for Actions SoC"
	depends on SOC_FAMILY_ACTS && FLASH
	default n
	help
	  Enable Actions SoC XSPI NOR flash driver.

config XSPI_MEM_ACTS
	bool "XSPI memory driver for Actions SoC"
	depends on SOC_FAMILY_ACTS
	default y
	help
	  Enable Actions SoC XSPI memory driver.

config XSPI_PSRAM_ACTS
	bool "SPI PSRAM driver for Actions SoC"
	depends on SOC_FAMILY_ACTS && FLASH && !SPI_PSRAM_GENERAL_SPI
	default n
	help
	  Enable Actions SoC XSPI PSRAM flash driver.

if XSPI_NOR_ACTS

config XSPI_NOR_ACTS_DEV_NAME
	string "XSPI NOR flash device name"
	depends on XSPI_NOR_ACTS
	default "xspi_nor"
	help
	  Specify the device name for XSPI NOR flash driver.

config XSPI_NOR_ACTS_IO_BUS_WIDTH
	int "XSPI NOR flash io bus width"
	depends on XSPI_NOR_ACTS
	range 1 4
	default 1
	help
	  Specify the io bus width(1, 2, 4) for XSPI NOR flash driver.

config XSPI_NOR_ACTS_DELAY_CHAIN
	int "XSPI delaychain config"
	depends on XSPI_NOR_ACTS
	default 8
	help
	  XSPI delaychain config.

config XSPI_NOR_ACTS_DEV_INIT_PRIORITY
	int "XSPI NOR flash device init priority"
	depends on XSPI_NOR_ACTS
	default 45
	help
	  This option controls the priority of XIP SPI NOR flash device
	  initialization. Lower values ensures that the device
	  is initialized earlier in the startup cycle. If unsure, leave
	  at default value.

config XSPI1_NOR_ACTS_DEV_INIT_PRIORITY
	int "XSPI1 NOR flash device init priority"
	depends on XSPI_NOR_ACTS
	default 46
	help
	  This option controls the priority of XIP SPI1 NOR flash device
	  initialization. Lower values ensures that the device
	  is initialized earlier in the startup cycle. If unsure, leave
	  at default value.

config XSPI_NOR_ACTS_DUMP_INFO
	bool "Dump SPINOR information at init stage"
	depends on XSPI_NOR_ACTS
	default n
	help
	  Dump SPINOR information at init stage.

config XSPI_NOR_ROM_ACTS
	bool "SPI NOR ROM driver for Actions SoC"
	depends on XSPI_NOR_ACTS
	default n
	help
	  Enable SPI NOR driver embedded in Actions SoC ROM.

config XSPI_NOR_AUTO_CHECK_RB
	bool "Auto check SPINOR ready/busy status by SPI controller"
	depends on XSPI_NOR_ACTS
	default n
	help
	  Enable auto check SPINOR ready/busy status by SPI controller.

config XSPI_NOR_SUSPEND_RESUME
	bool "enable suspend/resume by SPI controller"
	depends on XSPI_NOR_ACTS
	default n
	help
	  Enable suspend/resume by SPI controller.

config NOR_ACTS_DATA_PROTECTION_ENABLE
	bool "write protection"
	default n
	help
	  Enables write protection.

config XSPI1_NOR_ACTS
	bool "SPI1 NOR driver for Actions SoC"
	depends on XSPI_NOR_ACTS
	default n
	help
	  Enable SPI NOR driver embedded in Actions SoC ROM.

config XSPI1_NOR_ACTS_DEV_NAME
	string "SPI1 NOR flash device name"
	depends on XSPI_NOR_ACTS
	default "spi1_nor"
	help
	  Specify the device name for SPI1 NOR flash driver.
endif

config XSPI_ACTS_FREQ_MHZ
	int "XSPI0 clock frequence (MHz)"
	depends on XSPI_NOR_ACTS
	range 1 100
	default 50
	help
	  Specify the clock frequence (MHz) for XSPI0 driver.

config XSPI1_ACTS_FREQ_MHZ
	int "XSPI1 clock frequence (MHz)"
	depends on XSPI1_NOR_ACTS
	range 1 100
	default 50
	help
	  Specify the clock frequence (MHz) for XSPI1 driver.

config XSPI0_USE_COREPLL
    bool "XSPI0 use corepll"
    default n
    help
      XSPI0 use corepll

config XSPI1_USE_COREPLL
    bool "XSPI1 use corepll"
    default n
    help
      XSPI0 use corepll

config XSPI2_USE_COREPLL
    bool "XSPI2 use corepll"
    default n
    help
      XSPI2 use corepll

if XSPI_PSRAM_ACTS

config XSPI_PSRAM_ROM_ACTS
	bool "Use SPI ROM driver for Actions SoC"
	depends on XSPI_PSRAM_ACTS && XSPI_NOR_ROM_ACTS
	default y
	help
	  PSRAM device name for Actions SoC.
endif

endif
```

## drivers/hotplug/Kconfig
```kconfig
# Kconfig - Input device configuration options
#
#
# Copyright (c) 2017 Actions Semiconductor Co., Ltd
#
# SPDX-License-Identifier: Apache-2.0
#

menuconfig HOTPLUG
	bool
	prompt "Hot plug detect supply drivers"
	default n
	help
	  Enable Hot plug detect drivers configuration

if HOTPLUG

config HOTPLUG_LINEIN_DETECT
	bool "Actions SoC linein detect driver"
	depends on SOC_FAMILY_ACTS
	default n
	help
	  Enable support for Actions SoC linein detect driver.

config HOTPLUG_LINEIN_DETECT_ADC_NAME
	string "ADC device name for linein detect"
	default "ADC_0"
	help
	  This option specifies the ADC device name for linein detect.

config HOTPLUG_LINEIN_DETECT_ADC_CHAN
	int "ADC channel number for linein detect"
	help
	  This option specifies the ADC channel number for linein detect.

endif # HOTPLUG
```

## drivers/mmc/Kconfig
```kconfig
# Kconfig - MMC configuration options

#
# Copyright (c) 2015 Intel Corporation
#
# Licensed under the Apache License, Version 2.0 (the "License");
# you may not use this file except in compliance with the License.
# You may obtain a copy of the License at
#
#     http://www.apache.org/licenses/LICENSE-2.0
#
# Unless required by applicable law or agreed to in writing, software
# distributed under the License is distributed on an "AS IS" BASIS,
# WITHOUT WARRANTIES OR CONDITIONS OF ANY KIND, either express or implied.
# See the License for the specific language governing permissions and
# limitations under the License.
#

#
# MMC options
#
menuconfig MMC
	bool
	prompt "MMC Drivers"
	default n
	help
	Enable MMC Driver Configuration

if MMC

config MMC_0
	bool "Enable MMC Port 0"
	default n
	help
	  Enable MMC Port 0.

config MMC_0_IO_WIDTH
	int "MMC Port 0 io bus width"
	depends on MMC_0
	range 1 4
	default 1
	help
	  Specify the io bus width(1, 4) for MMC Port 0.

config MMC_0_DEVICE_NAME
	string "MMC Port 0 device name"
	default "MMC_0"
	depends on MMC_0
	help
	  Specify the MMC Port 0 device name.

config MMC_0_INIT_PRIORITY
	int "MMC Port 0 init priority"
	default 10
	help
	  Device driver initialization priority.

config MMC_1
	bool "Enable MMC Port 1"
	default n
	help
	  Enable MMC Port 1.

config MMC_1_IO_WIDTH
	int "MMC Port 1 io bus width"
	depends on MMC_1
	range 1 4
	default 1
	help
	  Specify the io bus width(1, 4) for MMC Port 1.

config MMC_1_DEVICE_NAME
	string "MMC Port 1 device name"
	default "MMC_1"
	depends on MMC_1
	help
	  Specify the MMC Port 1 device name.

config MMC_1_INIT_PRIORITY
	int "MMC Port 1 init priority"
	default 10
	help
	  Device driver initialization priority.

config MMC_SDCARD
	bool "Support SD Card"
	depends on FLASH
	default n
	help
	  Enable support for SD Card.

config MMC_SDCARD_MMC_DEV_NAME
	string "SD Card MMC device name"
	default "MMC_0"
	depends on MMC_SDCARD
	help
	  Specify the MMC device name which SD Card device is
	  connected.

config MMC_SDCARD_DEV_NAME
	string "SD Card device name"
	default "sd-storage"
	depends on MMC_SDCARD
	help
	  Specify the device name of SD Card device.

config MMC_SDCARD_LOW_POWER
	bool "Support SD Card/EMMC standby mode"
	depends on MMC_SDCARD
	default n
	help
	  Enable support for SD Card/EMMC standby mode, enter standby mode
	  after read/write.

config MMC_SDCARD_RETRY_TIMES
	int "SD Card retry times when initialzation failure"
	default 2
	depends on MMC_SDCARD
	help
	  Specify the initialzation retry times of SD Card device.

config MMC_SDCARD_LOW_POWER_SLEEP
	bool "Support EMMC sleep mode"
	depends on MMC_SDCARD_LOW_POWER
	default n
	help
	  Enable support for EMMC sleep mode, enter sleep mode
	  after read/write.

config MMC_SDIO
	bool "SDIO driver"
	depends on MMC
	default n
	help
	  Enable support for SDIO.

config MMC_SDIO_MMC_DEV_NAME
	string "SD Card MMC device name"
	default "MMC_1"
	depends on MMC_SDIO
	help
	  Specify the MMC device name which SDIO device is
	  connected.

config MMC_SDIO_ISR_THREAD
	bool "Use irq thread to handle SDIO irq"
	depends on MMC_SDIO
	default y
	help
	  Use irq thread to handle SDIO irq to avoid doing too mutch work
	  in irq context.

config MMC_SDIO_GPIO_IRQ
	bool "Use GPIO irq for SDIO irq"
	depends on MMC_SDIO && GPIO
	default n
	help
	  Use GPIO irq for SDIO irq. Normally used for 1-bit width MMC IO bus.

config MMC_ACTS
	bool "Actions SoC MMC driver"
	depends on MMC
	default n
	help
	  Enable MMC Controller of Actions SoC

config MMC_0_DATA_REG_WIDTH
	int "MMC Port 1 data register width (n * byte)"
	depends on MMC_0 && MMC_ACTS
	range 1 4
	default 4
	help
	  Specify the data register width(1 or 4) for MMC Port 1.

config MMC_1_DATA_REG_WIDTH
	int "MMC Port 1 data register width (n * byte)"
	depends on MMC_1 && MMC_ACTS
	range 1 4
	default 4
	help
	  Specify the data register width(1 or 4) for MMC Port 1.

config MMC_ACTS_DMA
	bool "Enable DMA transfer for MMC driver"
	depends on MMC_ACTS
	default y
	help
	  Enable DMA transfer for MMC controller of Actions SoC.

config SOC_SD_USE_COREPLL
    bool "enable SD/MMC use corepll clock source"
	default n
    help
      enable SD/MMC use corepll clock source

config SD0_FREQ_MHZ
	int "SD0 clock frequence (MHz)"
	depends on SOC_SD_USE_COREPLL
	range 1 100
	default 48
	help
	  Specify the clock frequence (MHz) for SD0 driver.

config SD1_FREQ_MHZ
	int "XSPI1 clock frequence (MHz)"
	depends on SOC_SD_USE_COREPLL
	range 1 100
	default 48
	help
	  Specify the clock frequence (MHz) for SD1 driver.

config MMC_SDCARD_ERR_RETRY_NUM
	int "The retry number of sd card when error"
	depends on MMC_ACTS
	range 1 10
	default 2
	help
	  Specify the retry number of sd card read/write when error happened.

config MMC_SDCARD_SHOW_PERF
	bool "Show the transfer performance information"
	depends on MMC_ACTS
	default n
	help
	  If you say Y here, you will get the performance information such as bindwidth.

config MMC_ACTS_ERROR_DETAIL
	bool "Enable show error detail infomation"
	depends on MMC_ACTS
	default n
	help
	  Enable show detail error infomation when an error occurs.

config SYS_LOG_MMC_LEVEL
	int
	prompt "MMC log level"
	depends on MMC && SYS_LOG
	default 3
	help
	  Sets log level for MMC

	  Levels are:

	  - 0 OFF, do not write
	  - 1 ERROR, only write SYS_LOG_ERR
	  - 2 WARNING, write SYS_LOG_WRN in adition to previous level
	  - 3 INFO, write SYS_LOG_INF in adition to previous levels
	  - 4 DEBUG, write SYS_LOG_DBG in adition to previous levels
endif
```

## drivers/nvram/Kconfig
```kconfig
# Kconfig - flash driver configuration options

#
# Copyright (c) 2016 Intel Corporation
#
# SPDX-License-Identifier: Apache-2.0
#

#
# flash driver
#
menuconfig NVRAM_CONFIG
	bool
	prompt "Non-volatile config support"
	default n
	help
	  Enable support for Non-volatile config.

if NVRAM_CONFIG

config NVRAM_STORAGE_FLASH
	bool
	prompt "NVRAM based on Flash"
	depends on FLASH
	default y

config NVRAM_STORAGE_RAMSIM
	bool
	prompt "Simulated NVRAM based on RAM"
	depends on FLASH && !NVRAM_STORAGE_FLASH
	default n

config NVRAM_STORAGE_DEV_NAME
	string
	prompt "Storage device name for NVRAM"
	default "spinor"

config NVRAM_USER_STORAGE_EXT_FLASH
	bool
	prompt "NVRAM user region based on external Flash"
	depends on FLASH
	default n

config NVRAM_USER_STORAGE_DEV_NAME
	string
	prompt "Storage device name for NVRAM"
	default "spinor"

config NVRAM_FACTORY_REGION_BASE_ADDR
	hex "Factory read-only config base address in NVRAM"
	help
	  This option specifies the base address of factory config in the NVRAM,
	  It need be aligned with flash erase sector.

config NVRAM_FACTORY_REGION_SIZE
	hex "Factory read-only config size in NVRAM"
	help
	  This option specifies the size of factory config in the NVRAM,
	  It need be aligned with flash erase sector.

config NVRAM_FACTORY_REGION_SEGMENT_SIZE
	hex "Factory read-only region segment size"
	help
	  This option specifies the region segment size of factory config in the NVRAM,
	  It need be aligned with flash erase sector.

config NVRAM_STORAGE_FACTORY_RW_REGION
	bool
	prompt "Enable NVRAM FACTORY_RW_REGION"
	depends on FLASH
	default n

config NVRAM_FACTORY_RW_REGION_BASE_ADDR
	hex "Factory config base address in NVRAM"
	help
	  This option specifies the base address of factory config in the NVRAM,
	  It need be aligned with flash erase sector.

config NVRAM_FACTORY_RW_REGION_SIZE
	hex "Factory config size in NVRAM"
	help
	  This option specifies the size of factory read-only config in the NVRAM,
	  It need be aligned with flash erase sector.

config NVRAM_FACTORY_RW_REGION_SEGMENT_SIZE
	hex "Factory region segment size"
	help
	  This option specifies the region segment size of factory config in the NVRAM,
	  It need be aligned with flash erase sector.

config NVRAM_USER_REGION_BASE_ADDR
	hex "User region base address in NVRAM"
	help
	  This option specifies the base address of user config in the NVRAM,
	  It need be aligned with flash erase sector.

config NVRAM_USER_REGION_SIZE
	hex "Total size of user region in NVRAM"
	help
	  This option specifies the size of user config in the NVRAM,
	  It need be aligned with flash erase sector.

config NVRAM_USER_REGION_SEGMENT_SIZE
	hex "User region segment size"
	help
	  This option specifies the region segment size of user config in the NVRAM,
	  It need be aligned with flash erase sector.

config NVRAM_INIT_CLEAR_USER_REGION_SIZE
	hex "Clear user region size when NVRAM init"
	default 0
	help
	  This option specifies the clear size of user region,
	  [0 - NVRAM_WRITE_REGION_SIZE/2]. It would be
	  erased after NVRAM init.

config NVRAM_CONFIG_INIT_PRIORITY
	int "NVRAM config init priority"
	depends on NVRAM_CONFIG
	default 48
	help
	 This option controls the priority of SPINOR flash device
	 initialization. Lower values ensures that the device
	 is initialized earlier in the startup cycle. If unsure, leave
	 at default value.
endif
```

## drivers/power/Kconfig
```kconfig
# Kconfig - Input device configuration options
#
#
# Copyright (c) 2017 Actions Semiconductor Co., Ltd
#
# SPDX-License-Identifier: Apache-2.0
#

menuconfig POWER_SUPPLY
	bool
	prompt "Power supply drivers"
	default n
	help
	  Enable power supply drivers configuration

if POWER_SUPPLY

config POWER_SUPPLY_ACTS_BATTERY
	bool "Actions SoC battery power supply driver"
	depends on SOC_FAMILY_ACTS
	default n
	help
	  Enable support for Actions SoC battery driver.

config BATTERY_ACTS_ADC_NAME
	string "ADC device name for sampling battery voltage"
	default "ADC_0"
	help
	  This option specifies the ADC device name for sampling
	  battery voltage.

config BATTERY_ACTS_ADC_CHAN
	int "ADC channel number for sampling battery voltage"
	default 0
	help
	  This option specifies the ADC channel number for sampling
	  battery voltage.

endif # POWER_SUPPLY
```
