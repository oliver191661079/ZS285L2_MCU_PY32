## drivers/watchdog/Kconfig.acts
```kconfig
# Kconfig - Watchdog configuration options for Actions SoC Watchdog
#
#
# Copyright (c) 2017 Actions Semiconductor Co., Ltd
#
# SPDX-License-Identifier: Apache-2.0
#

if SOC_FAMILY_ACTS

menuconfig WDOG_ACTS
	bool "Actions SoC Watchdog (WDT) Driver"
	depends on SOC_FAMILY_ACTS
	default n
	help
	  Enable watchdog driver for Actions SoC.

config WDT_ACTS_START_AT_BOOT
	bool "Start Watchdog during boot"
	depends on WDOG_ACTS
	default n
	help
	  Enable this setting to allow WDOG to be automatically started
	  during device initialization. Note that once WDOG is started
	  it must be reloaded before the counter reaches 0, otherwise
	  the MCU will be reset.

config WDT_ACTS_DEVICE_NAME
	string "Device name for Watchdog (WDT)"
	depends on WDOG_ACTS
	default "WATCHDOG_0"
	help
	  Set the name used by WDT device during registration.

config WDT_ACTS_OVERFLOW_TIME
	int "actions watchdog overflow time"
	depends on WDOG_ACTS
	default 5000
	help
	  Set the name used by WDT device during registration.

config WDT_MODE_RESET
	bool "actions watchdog overflow reset or not"
	depends on WDOG_ACTS
	default y
	help
	  Set watchdog overflow reset or interrupt

endif # SOC_FAMILY_ACTS
```

## ext/actions/Kconfig
```kconfig
#
# Copyright (c) 2016 Intel Corporation
#
# SPDX-License-Identifier: Apache-2.0
#

menu "Actions sdk"

config ACTIONS_SDK
	bool
	prompt "Actions SDK Support"
	default n
	select ACTIONS_SDK_PORTING
	select ACTIONS_COMPONENT_FUNCTION
	select ACTIONS_LIBRARY
	select ACTIONS_EXTERNAL_LIBRARY
	select ACTIONS_UTILS
	select MEMOYR
	help
	  This option enables the Actions SDK FUNCTION.

choice
	prompt "Actions SDk Mode"
	default ACTIONS_SDK_FULL_MODE
	depends on ACTIONS_SDK
	help
	  Select Actions SDK mode.

config ACTIONS_SDK_FULL_MODE
	bool
	prompt "Actions SDK Full Function Mode"
	select SYSTEM
	select BLUETOOTH
	select MEDIA
	select INPUT
	select AUDIO_SYSTEM
	select DISPLAY
	select UI_MANAGER
	select POWER
	select CORE
	select PROPERTY
	select PROPERTY_CACHE
	select STREAM
	select ESD_MANAGER
	select SYS_STANDBY
	select PLAYTTS
	select PLAY_MERGE_TTS
	select DVFS
	select THREAD_TIMER
	select SYS_LOG
	select PRINTK
	select SYSTEM_SHELL
	select KERNEL_SHELL
	select INIT_STACKS
	select THREAD_MONITOR
	#select OBJECT_TRACING
	select CPU_LOAD_STAT
	select CPU_LOAD_DEBUG
	select SECTION_OVERLAY
	select THREAD_STACK_INFO
	select SYS_IRQ_LOCK
	select SYS_IRQ_LOCK_EXCEPT_BT_CON
	select XSPI_NOR_AUTO_CHECK_RB
	select XSPI_NOR_SUSPEND_RESUME
	select STACK_BACKTRACE
	select ASSERT
	select ALARM
	select SOC_FAMILY_ACTS
	select WATCHDOG
	select WDOG_ACTS
	select DEBUG_RAMDUMP
	help
	  This option enables the Actions SDK Full FUNCTION Mode.

config ACTIONS_SDK_MEM_OPT_MODE
	bool
	prompt "Actions SDK MEM OPT Function Mode"
	select SYSTEM
	select BLUETOOTH
	select MEDIA
	select INPUT
	select AUDIO
	select DISPLAY
	select POWER
	select PROPERTY
	select PROPERTY_CACHE
	select STREAM
	select ESD_MANAGER
	select SYS_STANDBY
	select PLAYTTS
	#select PLAY_KEYTONE
	select ACTS_RING_BUFFER
	select DVFS
	select THREAD_TIMER
	select SYS_LOG
	select PRINTK
	#select SYSTEM_SHELL
	#select KERNEL_SHELL
	select INIT_STACKS
	select THREAD_MONITOR
	#select OBJECT_TRACING
	#select CPU_LOAD_STAT
	#select CPU_LOAD_DEBUG
	select SECTION_OVERLAY
	select THREAD_STACK_INFO
	select SYS_IRQ_LOCK
	select SYS_IRQ_LOCK_EXCEPT_BT_CON
	select XSPI_NOR_AUTO_CHECK_RB
	select XSPI_NOR_SUSPEND_RESUME
	select STACK_BACKTRACE
	#select ASSERT
	select ALARM
	select DEBUG_RAMDUMP
	help
	  This option enables the Actions SDK MEM OPT Mode.

config ACTIONS_SDK_TINY_MODE
	bool
	prompt "Actions SDK Tiny Function Mode"
	select SYSTEM
	select PROPERTY
	select INIT_STACKS
	select THREAD_MONITOR
	select SYS_IRQ_LOCK
	select SYS_IRQ_LOCK_EXCEPT_BT_CON
	select XSPI_NOR_AUTO_CHECK_RB
	select XSPI_NOR_SUSPEND_RESUME
	help
	  This option enables the Actions SDK Tiny FUNCTION mode.

config ACTIONS_SDK_RECOVERY_MODE
	bool
	prompt "Actions SDK recovery Mode"
	select SYSTEM
	select PROPERTY
	select INIT_STACKS
	select THREAD_MONITOR
	select SYS_IRQ_LOCK
	select SYS_IRQ_LOCK_EXCEPT_BT_CON
	select XSPI_NOR_AUTO_CHECK_RB
	select XSPI_NOR_SUSPEND_RESUME
	select POWER
	select CORE
	select PROPERTY
	select PROPERTY_CACHE
	select STREAM
	select SYS_STANDBY
	select THREAD_TIMER
	select CPU_LOAD_STAT
	select SYS_LOG
	select PRINTK
	select SYSTEM_SHELL
	select KERNEL_SHELL
	select INIT_STACKS
	select THREAD_MONITOR
	select SECTION_OVERLAY
	select ASSERT
	select ALARM
	select ACTS_RING_BUFFER
	select WATCHDOG
	select WDOG_ACTS
	help
	  This option enables the Actions SDK RECOVERY FUNCTION mode.

endchoice

source "ext/actions/audio/Kconfig"
source "ext/actions/base/Kconfig"
source "ext/actions/system/Kconfig"
source "ext/actions/bluetooth/Kconfig"
source "ext/actions/media/Kconfig"
source "ext/actions/usb/Kconfig"
source "ext/actions/display/Kconfig"
source "ext/actions/ota/Kconfig"
source "ext/actions/porting/Kconfig"
source "ext/actions/att/Kconfig"
source "ext/actions/mp/Kconfig"
endmenu
```

## ext/actions/Kconfig.defconfig
```kconfig
#
# Copyright (c) 2016 Intel Corporation
#
# SPDX-License-Identifier: Apache-2.0
#

if ACTIONS_SDK

config SYS_CLOCK_TICKS_PER_SEC
	default 500

config SOC_WKEN_ONOFF_LONG_PRESS_TIMER
	default 1000

config HEAP_MEM_POOL_SIZE
	default 0

config NUM_MBOX_ASYNC_MSGS
	default 20

config MESSAGE_DEBUG
	default y

config NUM_PIPE_ASYNC_MSGS
	default 0

config CONTROLLER_HIGH_PRIORITY
	default -15

config SYSTEM_WORKQUEUE_PRIORITY
	default -1

config MEDIASRV_PRIORITY
	default 3

config BTSRV_PRIORITY
	default 5

config MAIN_THREAD_PRIORITY
	default 6

config APP_PRIORITY
	default 10

config CONTROLLER_HIGH_STACKSIZE
	default 1768

config SYSTEM_WORKQUEUE_STACK_SIZE
	default 1280

config IDLE_STACK_SIZE
	default 512

config MEDIASRV_STACKSIZE
	default 1792

config MAIN_STACK_SIZE
	default 1536

config APP_STACKSIZE
	default 1792

config BTSRV_STACKSIZE
	default 1536

config CONSOLE_SHELL_STACKSIZE
	default 1024

config ISR_STACK_SIZE
	default 2048

config BT_ATT_PREPARE_COUNT
	default 2

config BT_RX_BUF_LEN
	default 680

config BT_L2CAP_RX_MTU
	default 672

config BT_L2CAP_TX_BUF_COUNT
	default 10

config BT_L2CAP_TX_MTU
	default 672

config BT_RX_STACK_SIZE
	default 1536

config BT_HCI_TX_STACK_SIZE
	default 1024

config BT_HCI_ACL_FLOW_CONTROL
	default n

config BT_ATT_ENFORCE_FLOW
	default n

config BT_TWS_US281B
	default n


# USB device stack
# USB device general config
if USB_DEVICE
config USB_COMPOSITE_DEVICE_CLASS_NUM
	default 2

config USB_REQUEST_BUFFER_SIZE
	default 64

config SYS_LOG_USB_DEVICE_LEVEL
	default 4

config SYS_LOG_USB_DRIVER_LEVEL
	int
	default 4

config USB_DEVICE_STRING_DESC_MAX_LEN
	default 30

# USB device class: Composite Device(UAC & HID)
if USB_AUDIO_CLASS && USB_DEVICE_HID
config USB_APP_AUDIO_DEVICE_VID
	default 0x10d6

config USB_APP_AUDIO_DEVICE_PID
	default 0xb011

config USB_APP_AUDIO_DEVICE_MANUFACTURER
	default "Actions"

config USB_APP_AUDIO_DEVICE_PRODUCT
	default "USB Audio & HID"

config USB_APP_AUDIO_DEVICE_SN
	default "0123456789AB"

config SYS_LOG_USB_HID_LEVEL
	default 4

config SYS_LOG_USB_SOURCESINK_LEVEL
	default 4

config USB_HID_DEVICE_IF_NUM
	default 0

config USB_AUDIO_DEVICE_IF_NUM
	default 1

config HID_INTERRUPT_IN_EP_ADDR
	default 0x82

config HID_INTERRUPT_OUT_EP_ADDR
	default 0x03

config USB_AUDIO_CONTROL_UNIT
	default y

config USB_AUDIO_DOWNLOAD_CHANNEL_NUM
	default 2

config USB_AUDIO_UPLOAD_CHANNEL_NUM
	default 1

config USB_AUDIO_DEVICE_SOURCE_IN_EP_ADDR
	default 0x81

config USB_AUDIO_DEVICE_SINK_OUT_EP_ADDR
	default 0x02

config USB_AUDIO_DEVICE_SINK_MAINCH_CONFIG
	default 0x01

config USB_AUDIO_DEVICE_SINK_LOGICALCH01_CONFIG
	default 0x03

config USB_AUDIO_DEVICE_SINK_LOGICALCH02_CONFIG
	default 0x03

config USB_AUDIO_DEVICE_SOURCE_SAM_FREQ_UPLOAD
	default 16000

endif # USB_AUDIO_CLASS && USB_DEVICE_HID

# USB device class: stub
if USB_DEVICE_STUB

endif # USB_DEVICE_STUB

# USB device class: hid
if USB_DEVICE_HID

endif # USB_DEVICE_HID

# USB device class: cdc
if USB_CDC_ACM

endif # USB_CDC_ACM

# USB device class: audio
if USB_AUDIO_CLASS

endif # USB_AUDIO_CLASS

# USB device class: msc
if USB_MASS_STORAGE

config MASS_STORAGE_PRIORITY
	default -5

config MASS_STORAGE_DISK_PDRV
	default 4

config MASS_STORAGE_DISK_NAME
	default "SD"

config SYS_LOG_USB_MASS_STORAGE_LEVEL
	default 2

config MASS_STORAGE_MANUFACTURER
	default "Actions"

config MASS_STORAGE_PRODUCT
	default "MSC-Sample"

config MASS_STORAGE_SN
	default "0123456798AB"

config MASS_STORAGE_STACK_SIZE
	default 1024

config MASS_STORAGE_BUF_SIZE
	default 8192

config MASS_STORAGE_IN_EP_ADDR
	default 0x81

config MASS_STORAGE_OUT_EP_ADDR
	default 0x02

endif # USB_MASS_STORAGE
endif # USB_DEVICE

# USB host stack configs
if USB_HOST

endif # USB_HOST

# USB host storage diskio
config DISK_ACCESS_USB
	default n

if LEFT_CHANNEL_MUTE || RIGHT_CHANNEL_MUTE
config MEDIA_EFFECT_OUTMODE
	default 2
endif

endif
```

## ext/actions/audio/Kconfig
```kconfig
# Kconfig - Actions audio

#
# Copyright (c) 2016 Actions Corporation
#
# SPDX-License-Identifier: Apache-2.0
#

menuconfig AUDIO_SYSTEM
	bool
	prompt "Audio"
	select VOLUME_MANAGER
	default n
	help
	This option enables actions audio

config VOLUME_MANAGER
	bool
	prompt "actions volume manager"
	default n
	help
	This option enables actions actions volume manager.

config AUDIO_VOICE_HARDWARE_REFERENCE
    bool
    prompt "audio voice use hardware refernce signal"
    default n
    help
    This option enables audio voice use hardware reference signal

config AUDIO_DATA_DEBUG
    bool
    prompt "audio data and speed print"
    default n

config DSP_HFP_VERSION
    int
    prompt "Version of DSP HFP"
    default 0
    help
    This option selects the vertion of DSP HFP

config DSP_OUTPUT_24BIT_WIDTH_IN_BMS
    bool
    prompt "dsp output buffer is 24bit width for save buffer in bms sence"
    default n

config DSP_OUTPUT_1_CH_IN_BMS
    bool
    prompt "dsp output buffer is 1ch(1 speaker) for save buffer in bms sence"
    default n

config DSP_BYPASS_ADJUST_DA_VOLUME
    int "add a ajust da volume(0.1 db unit) in bypass mode"
    default 0

config DSP_FADEIN_FILL_ZERO
    bool
    prompt "dsp memset half buffer fadein to zero"
    default n

config AUDIO_TRACK_LESS_DATA_FADE
    bool
    prompt "audio track fade out when less data"
    default n

config AUDIO_MULTICORE_SYNC_PLAY
    bool
    prompt "audio multicore sync play"
    default n
    help
    This option enables audio multicore sync play

config AUDIO_MULTICORE_SYNC_GPIO_NUM
    int
    prompt "audio multicore sync gpio pin num"
    default 1
    help
    This option selects the audio multicore sync gpio pin num

config AUDIO_TRACK_MAX_RELOAD_BUFFER_SIZE
    int
    prompt "audio track max reload buffer size"
    default 1536
    help
    This option selects the audio track max reload buffer size

config AUDIO_SUPPORT_DYNAMIC_PEQ
    bool
    prompt "audio support dynamic peq"
    default n
    help
    This option selects the audio support dynamic peq or not"

 config ENERGY_SAMPLE_SUPPORT
    bool
    prompt "support energy sample"
    default n
    help
    This option enables energy sample

config AUDIO_MULTI_CHANNEL_MODE
    int
    prompt "Audio multi-channel mode"
    default 0
    help
    Set audio audio multi-channel mode. See definition of "MULTI_CH_MODE_*"
```

## ext/actions/base/utils/Kconfig
```kconfig
menuconfig ACTIONS_UTILS
    bool
    prompt "Actions Utils Support"
    default y
    help
    This option enables the actions test service.

config ACTS_RING_BUFFER
	bool
	prompt "Actions Ring Buffers Support"
	depends on ACTIONS_UTILS
	default n
	help
	Enable usage of actions ring buffers. This is similar to kernel ring buffer,
	except that it contains a device address and support arbitrary buffer size.
	For optimal performance, use buffer sizes that are a power of 2.

config ACTS_EBERGY_STATISTICS
	bool
	prompt "Actions Energy statistics"
	depends on ACTIONS_UTILS
	default n
	help
	Enable usage of actsions Enable actions Energy statistics.

config ACTS_TRANSCODE
	bool
	prompt "Actions Transcode Support"
	depends on ACTIONS_UTILS
	default n
	help
	Enable usage of actsions Enable actions transcode.

config LOGIC_ANALYZER
	bool
	prompt "Enable support to logic analyzer."
	default n

source "ext/actions/base/utils/stream/Kconfig"
source "ext/actions/base/utils/iterator/Kconfig"
source "ext/actions/base/utils/trace/Kconfig"
source "ext/actions/base/utils/img_load/Kconfig"
source "ext/actions/base/utils/at_parser/Kconfig"
```

## ext/actions/base/utils/at_parser/Kconfig
```kconfig
# Kconfig - Actions iterarator

#
# Copyright (c) 2016 Actions Corporation
#
# SPDX-License-Identifier: Apache-2.0
#

menuconfig AT_PARSER
	bool
	prompt "Actions at parser Support"
	depends on ACTIONS_UTILS
	default n
	help
	  This option enables actions at parser.

config AT_PARSER_MAX_CMD_LEN
	int
	prompt "at parser max command length"
	depends on AT_PARSER
	default 256
	help
	  This option config at parser max command length

config AT_PARSER_ON_DEV_NAME
	string "Device Name for at parser"
	default "UART_0"
	help
	This option specifies the name of AT device to be used for
	at parser.

config AT_PARSER_SUPPORT_URC
	bool
	prompt "Actions at parser urc support"
	depends on AT_PARSER
	default n
	help
	This option enables actions at parser urc support.	

config AT_PARSER_ENABLE_ZEPHYR_HAL
	bool
	prompt "Actions at parser zephyr hal support"
	depends on AT_PARSER
	default n
	help
	This option enables actions at parser zephyr hal.		

config AT_PARSER_ENABLE_FREERTOS_HAL
	bool
	prompt "Actions at parser freertos hal support"
	depends on AT_PARSER
	default n
	help
	This option enables actions at parser freertos hal.	
	
config AT_PARSER_TEST
	bool
	prompt "Actions at parser test support"
	depends on AT_PARSER
	default n
	help
	This option enables actions at parser test.		
```

## ext/actions/base/utils/iterator/Kconfig
```kconfig
# Kconfig - Actions iterarator

#
# Copyright (c) 2016 Actions Corporation
#
# SPDX-License-Identifier: Apache-2.0
#

menuconfig ITERATOR
	bool
	prompt "Actions Iterator Support"
	depends on ACTIONS_UTILS
	default n
	help
	  This option enables actions iterator.


choice
	prompt "play file selector Selection"
	default PLIST_ITERATOR
	depends on ITERATOR

	config FILE_ITERATOR
		bool
		prompt "File Iterator Support"
		depends on ITERATOR
		select FILE_SYSTEM
		help
		  This option enables actions file iterator.
	config PLIST_ITERATOR
		bool
		prompt "File Play List Iterator Support"
		depends on ITERATOR
		select FILE_SYSTEM
		help
		  This option enables actions file play list iterator.

	config BACKGROUND_ITERATOR
		bool
		prompt "File Play List Background scan Iterator Support"
		depends on ITERATOR
		select FILE_SYSTEM
		select MULTI_SCAN_DISK
		help
		  This option enables actions file play list scan in background iterator.

	config DYN_PLIST_ITERATOR
		bool
		prompt "Dynamics File Play List Iterator Support"
		depends on ITERATOR
		select FILE_SYSTEM
		select MULTI_SCAN_DISK
		help
		  This option enables actions file play list scan in background iterator.
endchoice

config PLIST_SUPPORT_FOLDER_CNT
	int
	prompt "Play list folder count support"
	depends on ITERATOR
	default 100
	help
	  This option set the folder count support by the play list.

config ITERATOR_SUPPORT_FILE_CNT
	int
	prompt "Iterator support file summury number"
	depends on ITERATOR
	default 10000
	help
	  This option set the folder count support by the play list.


config SUPPORT_FILE_FULL_NAME
	bool
	prompt "Play list support file full name"
	depends on ITERATOR
	default n
	help
	  This option enables the file full name support.
```
