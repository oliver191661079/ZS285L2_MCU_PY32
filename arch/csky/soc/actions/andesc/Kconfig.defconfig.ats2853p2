## arch/csky/soc/actions/andesc/Kconfig.soc
```kconfig
# Kconfig - Actions Bluetooth SoC configuration options

#
# Copyright (c) 2018 Actions Semiconductor Co., Ltd
#
# SPDX-License-Identifier: Apache-2.0
#

choice
	prompt "Actions Andesc Bluetooth SoC"
	depends on SOC_SERIES_ANDESC

source "arch/csky/soc/actions/andesc/Kconfig.soc.*"

endchoice

if SOC_SERIES_ANDESC

config SOC_CPU_CLK_FREQ
	int "CPU clock frequence (KHz)"
	range 30000 180000
	help
	  config Actions SoC CPU clock frequence (KHz)

config SOC_DSP_CLK_FREQ
	int "CPU clock frequence (KHz)"
	range 30000 180000
	help
	  config Actions SoC CPU clock frequence (KHz)

config SOC_VDD_VOLTAGE
	int "VDD Voltage (mV)"
	range 800 1500
	help
	  VDD Voltage (mV)

config SOC_SPICACHE_PROFILE
	bool "Enable SPI cache profile"
	default n
	help
	  Enable SPI cache profile for Andes SoC

config SOC_MAPPING_PSRAM
	bool "enable PSRAM mapping"
	default n
	help
	  Enable SPI cache profile for Andes SoC

if SOC_MAPPING_PSRAM
config SOC_MAPPING_PSRAM_ADDR
	hex "PSRAM mapping space base address"
	default 0
	help
	  PSRAM mapping space base address

config SOC_MAPPING_PSRAM_SIZE
	hex "PSRAM mapping space size"
	default 0
	help
	  PSRAM mapping space size

config SOC_MAPPING_PSRAM_FOR_OS
	bool "enable PSRAM mapping for OS"
	default n
	help
	  Enable PSRAM mapping for OS
endif

config HOSC_CLK_MHZ
    int
    default 24
    help
      config Actions SoC hosc frequency

config SOC_SPREAD_SPECTRUM
    bool "enable SOC spread spectrum"
    default y
    help
      enable SOC spread spectrum

config ESD_SUPPORT
    bool "support ESD"
    default y
    help
      config Actions SoC support ESD

config IDLE_CLOSE_CPU_CLK
    bool "close cpu clock when cpu is idle"
    default n
    help
        config close cpu clock when cpu excecute wait instuction

config CPU0_EJTAG_ENABLE
    bool "enable cpu0 ejtag or not"
    default y
    help
      config cpu0 ejtag enable

config CPU0_EJTAG_GROUP
    int "CPU0 EJTAG group select"
    default 0
    depends on CPU0_EJTAG_ENABLE
    help
      config cpu0 ejtag group

config CPU0_EJTAG_GROUP_EXCEPTION
    int "CPU0 EJTAG group select when system is in exception"
    default 0
    help
      config cpu0 ejtag group

config CPU_REBOOT_IF_EXCEPTION
    bool "CPU select reboot when system is in exception"
    default n
    help
      config cpu reboot if exception

config DSP_EJTAG_ENABLE
    bool "enable dsp ejtag or not"
    default n
    help
      config dsp ejtag enable

config DSP_EJTAG_GROUP
    int "DSP EJTAG group select"
    default 0
    depends on DSP_EJTAG_ENABLE
    help
      config dsp ejtag group

config PM_SLEEP_TIME_TRACE
    bool "Enable s3bt and s2 time trace"
    default n
    help
      Enable s3bt and s2 time trace

config SOC_SPI_USE_COREPLL
    bool "enable cpu spi use corepll clock source "
    default n
    help
      enable cpu spi use corepll clock source

config SOC_SPI_USE_SPLL
    bool "enable cpu spi use spll clock source "
    default n
    help
      enable cpu spi use corepll clock source

menu "SOC wakeup source"
config SOC_WKEN_DC5V
	bool "enable plug in 5v adapter to wakeup system"
	default y
	help
	  Enable plug in 5v adapter to wakeup system

config SOC_WKEN_BAT
	bool "enable plug in battery to wakeup system"
	default n
	help
	  Enable plug in battery to wakeup system

config SOC_WKEN_ONOFF_SHORT
	bool "enable short press onoff to wakeup system"
	default n
	help
	  Enable short press onoff to wakeup system

config SOC_AUTO_POWER_ON
	bool "boot automatically on power apply (no ON/OFF long-press gate)"
	default n
	help
	  When enabled, skip soc_pm_init logic that powers off again on
	  POWEROK unless ON/OFF long-press wakeup is detected.

config SOC_WKEN_ONOFF_LONG_PRESS_TIMER
	int "config long press onoff time MS to wake up system"
	default 1000
	help
	  Config long press onoff time MS to wake up system
endmenu

menu "SOC DVFS"
config SOC_DVFS
	bool "support DVFS"
	default n
	help
	  Support DVFS

config SOC_DVFS_DYNAMIC_LEVEL
	bool "support dynamic DVFS level"
	depends on SOC_DVFS
	default n
	help
	  Support dynamic DVFS level

config SOC_DVFS_CPU_IDLE_LOW_POWER
	bool "enable cpu to low power when idle"
	depends on SOC_DVFS
	default n
	help
	  Decease cpu frequence to when cpu is in idle state

config SOC_DVFS_CPU_IDLE_FREQ_KHZ
	int "cpu frequence in idle state (KHz)"
	depends on SOC_DVFS_CPU_IDLE_LOW_POWER
	range 10000 180000
	default 30000
	help
	  Reduce cpu frequence to save power consume when cpu is in idle state

config SOC_DVFS_S3BT_ENABLE
	bool "enable S3BT when idle"
	depends on SOC_DVFS
	default n
	help
	  Enter S3BT when cpu is in idle state

config FPGA_SIM
	bool "enable fpga sim or not"
	default n
	help
	  enable fpga sim or not
endmenu

endif
source "arch/csky/soc/actions/andesc/rom_config/Kconfig"
```

## boards/csky/ats2853p2_evb/Kconfig
```kconfig
# Copyright (c) 2026 Actions Semiconductor Co., Ltd
# SPDX-License-Identifier: Apache-2.0

if BOARD_ATS2853P2_EVB

config BOARD_UART1_TX_GPIO
	int "UART1 TX GPIO pin number"
	depends on UART_ACTS_PORT_1
	default 21
	help
	  SoC GPIO index for UART1 TX.
	  285L2 V2.1: GPIO21 (MFP=0xe, 表6.4)

config BOARD_UART1_RX_GPIO
	int "UART1 RX GPIO pin number"
	depends on UART_ACTS_PORT_1
	default 22
	help
	  SoC GPIO index for UART1 RX (mux 0xe). 285L2 PY32 link: GPIO22.

endif
```

## boards/csky/ats2853p2_evb/Kconfig.board
```kconfig
config BOARD_ATS2853P2_EVB
	bool "ATS2853 Evaluate Board"
	depends on SOC_ATS2853P2
```

## boards/csky/ats2853p2_evb/Kconfig.defconfig
```kconfig
if BOARD_ATS2853P2_EVB

config BOARD
	default ats2853p2_evb

config RUN_IN_SPI0_EXT_NOR
	bool
    prompt "config code in spi0 external nor flash or not"
    default n
    help
    This option config code in spi0 external nor flash or not

endif
```

## boards/csky/ats2853p2_evb/ats2853p2_evb_defconfig
```kconfig
CONFIG_CSKY=y
CONFIG_CPU_CSKYV2L=y
CONFIG_CPU_CK802=y
CONFIG_CSKY_CORETIM=n
CONFIG_STACK_BACKTRACE=n
CONFIG_BOARD_ATS2853P2_EVB=y
CONFIG_BOARD="ats2853p2_evb"
CONFIG_SOC_FAMILY_ACTIONS=y
CONFIG_SOC_SERIES_ANDESC=y
CONFIG_SOC_SERIES_ANDESC_P2=y
CONFIG_SOC_ATS2853P2=y
CONFIG_ACTS_TIMER=y
CONFIG_ACTS_HRTIMER=y
CONFIG_CONSOLE=y
CONFIG_UART_CONSOLE=y
CONFIG_EARLY_CONSOLE=y
CONFIG_PRINTK=y
CONFIG_STDOUT_CONSOLE=y
CONFIG_UART_CONSOLE_ON_DEV_NAME="UART_0"
CONFIG_SYS_CLOCK_TICKS_PER_SEC=1000

#较早设置uart console优先级，方便早期即可以使用串口打印
CONFIG_UART_CONSOLE_INIT_PRIORITY=1
CONFIG_SERIAL=y
CONFIG_UART_ACTS=y
CONFIG_UART_INTERRUPT_DRIVEN=y
CONFIG_UART_ACTS_PORT_0=y
CONFIG_UART_ACTS_PORT_0_NAME="UART_0"
CONFIG_UART_ACTS_PORT_0_PRIORITY=0
CONFIG_UART_ACTS_PORT_0_BAUD_RATE=115200
CONFIG_UART_ACTS_PORT_1=y
CONFIG_UART_ACTS_PORT_1_BAUD_RATE=115200
CONFIG_BOARD_UART1_TX_GPIO=21
CONFIG_BOARD_UART1_RX_GPIO=22
CONFIG_UART_STUB_BAUD_RATE=115200

CONFIG_UART_DMA_RX_DRIVEN=y
CONFIG_UART_DMA_RX_TIMEOUT_DRIVEN=y

CONFIG_ASSERT=y
#config sdk running in external spi 0 nor flash nor not
# if set as 'y',
#1. need to check CONFIG_XSPI_NOR_ACTS_IO_BUS_WIDTH and pin configuration whether fits with the board.
#2. need to modify SYSTEM_DISK_STORAGE_MFP as 1 int scripts/support/actions/prebuilt/andesc/common/bin/fw_maker_ext.cfg.
#3. make sure the innernal nor flash is empty.
CONFIG_RUN_IN_SPI0_EXT_NOR=n

CONFIG_FLASH=y
CONFIG_FLASH_SIZE=2000
CONFIG_XSPI_NOR_ACTS=y
CONFIG_XSPI_NOR_ACTS_DEV_NAME="xspi_nor"
CONFIG_XSPI_NOR_ACTS_IO_BUS_WIDTH=4
CONFIG_XSPI_NOR_ACTS_DEV_INIT_PRIORITY=45
CONFIG_XSPI_NOR_ACTS_DUMP_INFO=y
CONFIG_XSPI_NOR_ROM_ACTS=y
CONFIG_NOR_ACTS_DATA_PROTECTION_ENABLE=y
CONFIG_XSPI_NOR_ACTS_DELAY_CHAIN=4
CONFIG_XSPI_ACTS_FREQ_MHZ=64
CONFIG_SOC_SPI_USE_SPLL=y
CONFIG_SOC_SPI_USE_COREPLL=n
CONFIG_XSPI0_USE_COREPLL=n
CONFIG_XSPI1_USE_COREPLL=n
CONFIG_XSPI2_USE_COREPLL=n

CONFIG_NVRAM_CONFIG=y
CONFIG_NVRAM_STORAGE_FLASH=y
CONFIG_NVRAM_STORAGE_DEV_NAME="xspi_nor"
CONFIG_NVRAM_STORAGE_FACTORY_RW_REGION=y

CONFIG_NVRAM_FACTORY_REGION_BASE_ADDR=0x3f0000
CONFIG_NVRAM_FACTORY_REGION_SIZE=0x2000
CONFIG_NVRAM_FACTORY_REGION_SEGMENT_SIZE=0x1000
CONFIG_NVRAM_FACTORY_RW_REGION_BASE_ADDR=0x3f2000
CONFIG_NVRAM_FACTORY_RW_REGION_SIZE=0x2000
CONFIG_NVRAM_FACTORY_RW_REGION_SEGMENT_SIZE=0x1000
CONFIG_NVRAM_USER_REGION_BASE_ADDR=0x3f4000
CONFIG_NVRAM_USER_REGION_SIZE=0xc000
CONFIG_NVRAM_USER_REGION_SEGMENT_SIZE=0x2000
CONFIG_NVRAM_INIT_CLEAR_WRITE_REGION_SIZE=0x4000
CONFIG_NVRAM_CAHCE=y

CONFIG_GPIO=y
CONFIG_GPIO_ACTS=y
CONFIG_GPIO_ACTS_DEV_NAME="GPIO_0"

CONFIG_DMA=y
CONFIG_DMA_ACTS_ANDES=n
CONFIG_VDMA_ACTS_ANDES=y

CONFIG_CMD_FLASH=y
CONFIG_CMD_REBOOT=y

CONFIG_GPIO_WIO_ACTS=y
CONFIG_GPIO_WIO_ACTS_DEV_NAME="WIO"
CONFIG_ADC=y
CONFIG_ADC_ACTS=y

CONFIG_INPUT_DEV=y
CONFIG_INPUT_DEV_ACTS_ADCKEY=y
CONFIG_INPUT_DEV_ACTS_ADCKEY_ADC_CHAN=5
CONFIG_INPUT_DEV_ACTS_ONOFF_KEY=y
CONFIG_LED=y
CONFIG_PWM=y
CONFIG_PWM_ACTS=y
CONFIG_PWM_CLK_DIV=7

#BT Controller uses GPIO5,8,9,10,16,21
CONFIG_BT_CONTROLER_DEBUG_GPIO=y

CONFIG_I2C=n
CONFIG_I2C_BITBANG_ACTS=n
CONFIG_I2C_GPIO=n
CONFIG_I2C_GPIO_1=n
CONFIG_I2C_GPIO_1_GPIO="GPIO_0"
CONFIG_I2C_GPIO_1_SCL_PIN=0
CONFIG_I2C_GPIO_1_SDA_PIN=1


CONFIG_I2C_SLAVE=n
CONFIG_I2C_SLAVE_0=n
CONFIG_I2C_SLAVE_ACTS=n
CONFIG_I2C_SLAVE_0_SCL_PIN=0
#- 0 - 19- 30- 42
CONFIG_I2C_SLAVE_0_SDA_PIN=1
#- 1 - 19- 29- 43

CONFIG_AUDIO_OUT_I2STX0_SUPPORT=n
CONFIG_AUDIO_IN_I2SRX0_SUPPORT=n
CONFIG_AUDIO_IN_I2SRX1_SUPPORT=n

CONFIG_AUDIO_OUT_SPDIFTX_SUPPORT=n
CONFIG_AUDIO_IN_SPDIFRX_SUPPORT=n

CONFIG_I2S1_PSEUDO_5WIRE=n
# 0-非直驱输出， 1-直驱输出
CONFIG_AUDIO_OUT_DD_MODE=0
# 0-单端输出， 1-差分输出
CONFIG_AUDIO_OUT_SE_DF=0

# 0--aux0; 1--aux1; 2--aux2; 3--aux0/1 fully differential
CONFIG_LINEIN_HW_MAPPING=3
# 0--single ended; 1--fully differential
CONFIG_MIC0_HW_MAPPING=0
# 0--single ended; 1--fully differential
CONFIG_MIC1_HW_MAPPING=1
# 0--aux0; 1--aux1; 2--aux2; 3--aux0/1 fully differential
CONFIG_FM_HW_MAPPING=2

CONFIG_BOARD_EXTERNAL_PA_ENABLE=y
# 0--classA/B; 1--classD
CONFIG_EXTERN_PA_CLASS=1

CONFIG_CPU0_EJTAG_GROUP=0
CONFIG_CPU0_EJTAG_GROUP_EXCEPTION=0
CONFIG_DSP_EJTAG_ENABLE=n
CONFIG_DSP_EJTAG_GROUP=0

CONFIG_HOTPLUG=y
CONFIG_HOTPLUG_LINEIN_DETECT=y
CONFIG_HOTPLUG_LINEIN_DETECT_ADC_CHAN=5

CONFIG_MMC=y
CONFIG_MMC_0=y
CONFIG_MMC_0_DEVICE_NAME="MMC_0"
CONFIG_MMC_0_IO_WIDTH=1
CONFIG_MMC_0_ACTS_DMA_CHAN=-1
CONFIG_MMC_SDCARD=y
CONFIG_MMC_SDCARD_MMC_DEV_NAME="MMC_0"
CONFIG_MMC_ACTS=y

CONFIG_MPU_MONITOR_RAMFUNC_WRITE=y

CONFIG_POWER_SUPPLY=y
CONFIG_POWER_SUPPLY_ACTS_BATTERY=y
CONFIG_BATTERY_ACTS_ADC_NAME="ADC_0"
CONFIG_BATTERY_ACTS_ADC_CHAN=1
CONFIG_ROM_PERF_ENABLE=n

#蓝牙频偏配置
CONFIG_COMPENSATION=n
CONFIG_COMPENSATION_ACTS=n
CONFIG_TEMP_COMPENSATION_ACTS=n
CONFIG_TEMP_COMPENSATION_CRYSTLAL_CAP_ACTS=n
CONFIG_TEMP_COMPENSATION_BASE_BAND_ACTS=n
CONFIG_TEMP_COMPENSATION_BASE_BAND_DELTA=10
CONFIG_BT_TEMP_COMPENSATION_ACTS=n
CONFIG_CAP_TEMP_COMPENSATION_ACTS=n

CONFIG_COMPENSATION_DEFAULT_HOSC_CAP=110

CONFIG_RANDOM_GENERATOR=y
CONFIG_TEST_RANDOM_GENERATOR=y
CONFIG_PM_SLEEP_TIME_TRACE=n

#controler config
#是否使用BT controler的andes版本
CONFIG_BT_CONTROLER_ANDESC=y

CONFIG_XSPI_MEM_ACTS=n

#disk config
CONFIG_DISK_ACCESS_SD=y
CONFIG_SD_FS=y
CONFIG_SD_FS_VADDR_START=0x1800000
CONFIG_DSP_LIB_IN_SDFS=y

#BOOT information
CONFIG_BOOTINFO_MEMORY=y
CONFIG_SOC_SECURE_BOOT=n
```

## drivers/Kconfig
```kconfig
# Kconfig - drivers configuration options

#
# Copyright (c) 2015 Intel Corporation
#
# SPDX-License-Identifier: Apache-2.0
#


menu "Device Drivers"

source "drivers/bluetooth/Kconfig"

config IEEE802154
       bool
       default n
       default y if NETWORKING_WITH_15_4 || NET_L2_IEEE802154

source "drivers/ieee802154/Kconfig"

source "drivers/console/Kconfig"

source "drivers/ethernet/Kconfig"

source "drivers/slip/Kconfig"

source "drivers/serial/Kconfig"

source "drivers/interrupt_controller/Kconfig"

source "drivers/timer/Kconfig"

source "drivers/random/Kconfig"

source "drivers/grove/Kconfig"

source "drivers/pci/Kconfig"

source "drivers/gpio/Kconfig"

source "drivers/shared_irq/Kconfig"

source "drivers/spi/Kconfig"

source "drivers/i2c/Kconfig"

source "drivers/i2s/Kconfig"

source "drivers/pwm/Kconfig"

source "drivers/pinmux/Kconfig"

source "drivers/adc/Kconfig"

source "drivers/rtc/Kconfig"

source "drivers/watchdog/Kconfig"

source "drivers/clock_control/Kconfig"

source "drivers/ipm/Kconfig"

source "drivers/aio/Kconfig"

source "drivers/flash/Kconfig"

source "drivers/sensor/Kconfig"

source "drivers/counter/Kconfig"

source "drivers/dma/Kconfig"

source "drivers/usb/Kconfig"

source "drivers/crypto/Kconfig"

source "drivers/mmc/Kconfig"

source "drivers/wifi/Kconfig"

source "drivers/audio/Kconfig"

source "drivers/input/Kconfig"

source "drivers/nvram/Kconfig"

source "drivers/power/Kconfig"

source "drivers/display/Kconfig"

source "drivers/dsp/Kconfig"

source "drivers/sbc_encoder/Kconfig"

source "drivers/mpu/Kconfig"

source "drivers/spidev/Kconfig"

source "drivers/stub/Kconfig"

source "drivers/stub_uart/Kconfig"

source "drivers/hotplug/Kconfig"

source "drivers/compensation/Kconfig"

source "drivers/fm/Kconfig"

source "drivers/amp/Kconfig"

source "drivers/pa_tas2780/Kconfig"

source "drivers/codec_acm8635/Kconfig"

source "drivers/logic_mcu_ls8a10023t/Kconfig"

endmenu
```
