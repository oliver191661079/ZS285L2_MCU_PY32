## ext/actions/base/utils/stream/Kconfig
```kconfig
# Kconfig - Actions stream function

#
# Copyright (c) 2016 Actions Corporation
#
# SPDX-License-Identifier: Apache-2.0
#

menuconfig STREAM
	bool
	depends on ACTIONS_UTILS
	prompt "Actions Stream Support"
	default n
	help
	This option enables actions stream .

config FILE_STREAM
	bool
	prompt "file stream Support"
	depends on STREAM
	select FILE_SYSTEM
	default n
	help
	This option enables actions file stream .

config LOOP_FSTREAM
	bool
	prompt "loop fstream Support"
	depends on STREAM
	select FILE_SYSTEM
	default n
	help
	This option enables actions loop fstream .

config BUFFER_STREAM
	bool
	prompt "buffer stream Support"
	depends on STREAM
	default n
	help
	This option enables actions buffer stream .

config RINGBUFF_STREAM
	bool
	prompt "buffer stream Support"
	depends on STREAM
	select ACTS_RING_BUFFER
	default n
	help
	This option enables actions buffer stream .

config PSRAM_STREAM
	bool
	prompt "Psram Stream Support"
	depends on STREAM
	default n
	help
	This option enables actions Psram stream .

config CLONE_STREAM
	bool
	prompt "clone stream Support"
	depends on STREAM
	default n
	help
	This option enables actions clone stream .

config ZERO_STREAM
	bool
	prompt "zero stream Support"
	depends on STREAM
	default n
	help
	This option enables actions zero stream .

config UART_STREAM
	bool
	prompt "uart stream Support"
	select UART_DMA_RX_DRIVEN
	default n
	help
	This option enables actions uart stream .	

config CDC_UART_STREAM
	bool
	prompt "cdc uart stream Support"
	default n
	help
	This option enables actions cdc uart stream .

config UART_AT_STREAM
	bool
	prompt "uart at stream Support"
	select UART_DMA_RX_DRIVEN
	default n
	help
	This option enables actions uart at stream .	
```

## ext/actions/base/utils/trace/Kconfig
```kconfig
config ACTIONS_TRACE
    bool
    prompt "actions trace Support"
    default y
    help
    This option enables the actions trace service.

config TRACE_UART
    bool
    prompt "actions trace uart Support"
    depends on ACTIONS_TRACE
    default y

config TRACE_FILE
    bool
    prompt "actions trace file Support"
    depends on ACTIONS_TRACE
    default n

config TRACE_CONTEXT_SHELLTASK
    bool
    prompt "trace output context by shell thread or not"
    depends on ACTIONS_TRACE
    default n

config TRACE_SYNC_SHELL_THREAD
    bool
    prompt "trace shell thread use sync mode or not"
    depends on ACTIONS_TRACE
    default n

config TRACE_BUFFER_SIZE
    int
    prompt "trace buffer size"
    default 4096

config TRACE_PERF_ENABLE
    bool
    prompt "trace performance enable"
    depends on ACTIONS_TRACE
    default n

config TRACE_USE_ROM_CODE
    bool
    prompt "trace use rom vsnprintf"
    depends on ACTIONS_TRACE
    default n

config TRACE_TIME_FREFIX
    bool
    prompt "trace use timestamp prefix"
    depends on ACTIONS_TRACE
    default n

config CONSOLE_ACTIONS_INIT_PRIORITY
    int
    prompt "actions trace init priority"
    depends on ACTIONS_TRACE
    default 61
```

## ext/actions/bluetooth/bt_stack/Kconfig.fpms
```kconfig
# Bluetooth GATT Battery service

# Copyright (c) 2018 Nordic Semiconductor ASA
# SPDX-License-Identifier: Apache-2.0

config BT_FPMS
	bool "Enable Fast pair message stream service"
	default n

config BT_FPMS_LOG_LEVEL
	int "Fast pair message stream service log level"
	depends on LOG
	range 0 4
	default 0
	depends on BT_FPMS
	help
	  Sets log level for the Fast pair message stream service.
	  Levels are:
	  0 OFF, do not write
	  1 ERROR, only write LOG_ERR
	  2 WARNING, write LOG_WRN in addition to previous level
	  3 INFO, write LOG_INF in addition to previous levels
	  4 DEBUG, write LOG_DBG in addition to previous levels
```
