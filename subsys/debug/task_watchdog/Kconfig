## subsys/debug/task_watchdog/Kconfig
```kconfig
# Copyright (c) 2020 Intel Corporation.
# SPDX-License-Identifier: Apache-2.0

config TASK_WDT
	bool
	prompt "enable task watchdog"
	default n
	help
	  This option enable task watchdog support.
```

## subsys/recovery/Kconfig
```kconfig
# Kconfig - System recovery options
#
# Copyright (c) 2017 Actions Semiconductor Co.,Ltd
#
# SPDX-License-Identifier: Apache-2.0
#

menu "Recovery Options"

config SYSTEM_RECOVERY
	bool
	prompt "Support system recovery"
	depends on NVRAM_CONFIG
	default n
	help
	  This option enable system recovery support

config SYSTEM_RECOVERY_INIT_PRIORITY
	int "System recovery checking init priority"
	depends on NVRAM_CONFIG
	default 50
	help
	 This option controls the priority of system recovery checking
	 initialization. Lower values ensures that the device
	 is initialized earlier in the startup cycle. If unsure, leave
	 at default value.

config SYSTEM_RECOVERY_CHECK_OTA_FLAG
	bool
	prompt "Check OTA flag at boot stage"
	depends on SYSTEM_RECOVERY
	default y
	help
	  This option enable ota flag checking to avoid unsuccessful OTA upgrade

config SYSTEM_RECOVERY_CHECK_BOOT_FLAG
	bool
	prompt "Check the times of boot failed flag at boot stage"
	depends on SYSTEM_RECOVERY
	default n
	help
	  This option enable boot flag checking to avoid unsuccessful boot

endmenu
```

## subsys/shell/modules/Kconfig
```kconfig
# Kconfig - Shell configuration options

#
# Copyright (c) 2016 Intel Corporation
#
# SPDX-License-Identifier: Apache-2.0
#

config KERNEL_SHELL
	bool "Enable kernel shell"
	default n
	help
	  This shell provides access to basic kernel data like version, uptime
	  and other useful information.

config CMD_MEMORY
	bool "Enable memory commands"
	default y
	help
	  Memeory commands.
	    mdw - memory display by word
	    mdh - memory display by half-word
	    mdb - memory display by byte
	    mww - memory write (fill) by word
	    mwh - memory write (fill) by half-word
	    mwb - memory write (fill) by byte

config CMD_FLASH
	bool "Enable flash operation command"
	default y
	help
	  Flash commands.
	    flash erase - erase flash
	    flash read - read flash
	    flash write - write flash
	    flash info - dump flash information

config CMD_REBOOT
	bool "Enable reboot command"
	default y
	help
	  enable reboot command.

config CMD_POWEROFF
	bool "Power off system command"
	default y
	help
	  Power off system command.

config CMD_JTAG
	bool "enable JTAG command"
	default y
	help
	  Enable JTAG command.

source "subsys/shell/modules/extnetshell/Kconfig"
```
