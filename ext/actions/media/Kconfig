## ext/actions/media/Kconfig
```kconfig
# Kconfig - Actions media player

#
# Copyright (c) 2016 Actions Corporation
#
# SPDX-License-Identifier: Apache-2.0
#

menuconfig MEDIA
	bool
	prompt "media"
	select MEDIA_PLAYER
	default n
	help
	This option enables actions media

config MEDIA_PLAYER
	bool
	prompt "media player Support"
	depends on MEDIA
	select MEDIA_SERVICE
	select STREAM
	select RINGBUFF_STREAM
	default n
	help
	This option enables actions media player

config MEDIA_SERVICE
	bool
	prompt "Media Service Support"
	select THREAD_TIMER
	select AUDIO_SYSTEM
	default n
	help
	This option enables actions Media service.

config MEDIASRV_PRIORITY
    int
    prompt "Media Service Thread Priority"
    default 4
    depends on MEDIA_SERVICE
    help
    This option set audio thread priority

config MEDIASRV_STACKSIZE
    int
    prompt "Media Service Thread Stack Size"
    default 2048
    depends on MEDIA_SERVICE
    help
    This option set stack size for audio service thread


config MEDIA_EFFECT
	bool
	prompt "media effect Support"
	depends on MEDIA_PLAYER
	default n
	help
	This option enables actions media effect

config MEDIA_EFFECT_OUTMODE
	int
	prompt "media effect output mode Support"
	depends on MEDIA_PLAYER
	default 0
	help
	This option enables actions media output mode

config MUSIC_EFFECT
	bool
	prompt "music effect Support"
	depends on MEDIA_PLAYER
	depends on MEDIA_EFFECT
	select MUSIC_DAE
	# select MUSIC_DAE_FADE
	default n
	help
	This option enables actions music effect

config MUSIC_DRC_EFFECT
	bool
	prompt "music drc effect Support"
	depends on MUSIC_EFFECT
	depends on MEDIA_EFFECT
	default n
	help
	This option enables actions music drc effect

config MUSIC_EXTERNAL_EFFECT
	bool
	prompt "music externl effect Support"
	depends on MEDIA_PLAYER
	select MUSIC_EFFECT
	default n
	help
	This option enables external music effect

config MUSIC_EXTERNAL_EFFECT_MIC_STREAM
	bool
	prompt "music externl effect mic stream"
	depends on MEDIA_PLAYER
	select MUSIC_EXTERNAL_EFFECT
	default n
	help
	This option enables external music effect mic stream

config VOICE_EFFECT
	bool
	prompt "voice effect Support"
	depends on MEDIA_EFFECT
	default n
	help
	This option enables actions voice effect

config AEC_TAIL_LENGTH
	int
	prompt "AEC tail length config"
	depends on VOICE_EFFECT
	default 48
	help
	This option set AEC tail length config

config AUDIO_SUBWOOFER
    bool
    prompt "audio subwoofer Support"
    depends on MEDIA_PLAYER
    default n
    help
    This option enables actions audio subwoofer function.

config AUDIO_SUBWOOFER_USE_I2S
    bool
    prompt "audio subwoofer use I2S or internal DAC"
    depends on AUDIO_SUBWOOFER
    select AUDIO_OUT_I2STX0_SUPPORT
    default n
    help
    This option enables audio subwoofer use internal dac or external i2s device
    

source "ext/actions/media/libal/Kconfig"
```

## ext/actions/porting/hal/bluetooth/bt_drv/Kconfig
```kconfig
# Kconfig - ACTIONS primitive options for sdk version 2.0

#
# Copyright (c) 2015 Intel Corporation
#
# Licensed under the Apache License, Version 2.0 (the "License");
# you may not use this file except in compliance with the License.
# You may obtain a copy of the License at
#
#     http://www.apache.org/licenses/LICENSE-2.0
#
# Unless required by applicable law or agreed to in writing, software
# distributed under the License is distributed on an "AS IS" BASIS,
# WITHOUT WARRANTIES OR CONDITIONS OF ANY KIND, either express or implied.
# See the License for the specific language governing permissions and
# limitations under the License.
#

config BT_DRV_WOODPECKER_PHOENIX
    bool
    prompt "Actions Bluetooth controller driver (Phoenix) for Woodpecker SoC"
	depends on BT_DRV
    depends on SOC_SERIES_WOODPECKER || SOC_SERIES_WOODPECKERFPGA
	select COMPENSATION_ACTS
    default n
    help
    This option enables Actions Bluetooth controller Woodpecker SoC.

config BT_DRV_ANDESC_PHOENIX
    bool
    prompt "Actions Bluetooth controller driver (Phoenix) for Andesc SoC"
	depends on BT_DRV
    depends on SOC_SERIES_ANDESC
	#select COMPENSATION_ACTS
    default n
    help
    This option enables Actions Bluetooth controller Woodpecker SoC.

config BT_CONTROLER_DEBUG_PRINT
    bool
    prompt "Actions controler debug print"
	depends on BT_DRV
    default y
    help
    This option enables Actions controler debug print

config BT_CONTROLER_DEBUG_GPIO
    bool
    prompt "Actions controler debug gpio pin"
	depends on BT_DRV
    default n
    help
    This option enables Actions controler debug gpio pin

config BT_CONTROLER_DEBUG_CIS_RX
    bool
    prompt "Actions controler debug CIS rx max latency"
    depends on BT_DRV
    depends on BT_DRV_ANDESC_PHOENIX
    default n
    help
      This option enables Actions controler debug CIS rx max latency

config BT_CONTROLER_DISABLE_BLE_CHN_ASSESS
    bool
    prompt "Actions controller disable BLE channel assess"
    depends on BT_DRV
    depends on BT_DRV_ANDESC_PHOENIX
    default n
    help
      This option disables Actions controller BLE channel assess

config BT_CONTROLER_CIS_REAL_TRANS_MAX_NUM
    int
    prompt "Actions controler CIS real translate max num"
    depends on BT_DRV
    depends on BT_DRV_ANDESC_PHOENIX
    default 255
    help
      This option enables Actions controler debug CIS rx max latency

config BT_CONTROLER_MAX_TXPOWER
    int
    prompt "Bluetooth Controller Max TX power (unit: 0.1 db)"
    depends on BT_DRV
    default 80
    help
    This option config Bluetooth Controller Max TX power (unit: 0.1 db)

config BT_CONTROLER_BLE_MAX_TXPOWER
    int
    prompt "Bluetooth Controller Max TX power (unit: 0.1 db)"
    depends on BT_DRV
    default 80
    help
    This option config Bluetooth Controller Max TX power (unit: 0.1 db)

config BT_HCI_RX_PRINT
    bool    
    prompt "Actions Bluetooth hci RX Print"
	depends on BT_DRV
    depends on SOC_SERIES_ANDES || SOC_SERIES_ANDESM
    default n
    help
    This option enables Actions Bluetooth controller Andes RX Print
    
config BT_HCI_TX_PRINT
    bool    
    prompt "Actions Bluetooth hci TX Print"
	depends on BT_DRV
    depends on SOC_SERIES_ANDES || SOC_SERIES_ANDESM
    default n
    help
    This option enables Actions Bluetooth controller Andes TX Print   

config BT_CONTROLER_BQB
    bool    
    prompt "Actions Bluetooth Controller BQB test"
	depends on BT_DRV
    depends on SOC_SERIES_ANDES || SOC_SERIES_ANDESM || SOC_SERIES_WOODPECKER || SOC_SERIES_ANDESC
    default n
    help
    This option enables Actions Bluetooth Controller BQB test   

config BT_CONTROLER_BLE_BQB
    bool    
    prompt "Actions Bluetooth Controller BQB ble test"
    depends on BT_DRV
    depends on SOC_SERIES_ANDES || SOC_SERIES_ANDESM || SOC_SERIES_WOODPECKER || SOC_SERIES_ANDESC
    depends on BT_CONTROLER_BQB
    default n
    help
    This option enables Actions Bluetooth Controller ble BQB test

config BT_BQB_UART_PORT
	int "UART port id for BQB mode, and FCC mode"
	depends on BT_CONTROLER_BLE_BQB
	range [0 1]
	default 1
	help
	This option config UART port id for BQB mode, and FCC mode

config BT_CONTROLER_SUPPORT_EDR3M
	bool "support EDR 3M"
	depends on BT_DRV
	default n
	help
	This option enable support for EDR 3M

config BT_CON_POOL_SIZE
	int "bt controller pool buffers size (kbytes)"
	default 18
	help
	  bt controller pool buffers size.
```

## ext/actions/system/Kconfig
```kconfig
# Kconfig - Actions system manager

#
# Copyright (c) 2016 Actions Corporation
#
# SPDX-License-Identifier: Apache-2.0
#

menuconfig SYSTEM
	bool
	prompt "System"
	default n
	help
	This option enables actions system manager.

config ESD_MANAGER
	bool
	prompt "Esd Manager Support"
	depends on SYSTEM
	default n
	help
	This option enables actions esd manager.

config SYS_STANDBY
	bool
	prompt "System Standby Support"
	depends on SYSTEM
	select SYS_WAKELOCK
	select PM_CPU_IDLE_LOW_POWER
	default n
	help
	This option enables actions system standby.

config SYS_STANDBY_CONTROL_LEADV
	bool
	prompt "Control Leadv When System Standby"
	depends on SYSTEM
	default n
	help
	This option control leadv when system standby.

config SYS_WAKELOCK
	bool
	prompt "System Wake Lock Support"
	depends on SYSTEM
	default n
	help
	This option enables actions system wake lock.

config AUTO_STANDBY_TIME_SEC
    int "delay how long (second) to enter standby"
    depends on SYS_STANDBY
	default 0
    help
    This option set the time to enter standby when system idle

config AUTO_POWEDOWN_TIME_SEC
    int "delay how long (second) to auto power down"
    depends on SYS_STANDBY
	default 1800
    help
    This option set the time to enter auto power down

config AUTO_POWEDOWN_UNCONNECTED
    bool 
    prompt "Poweroff When No Device Connected Support"
	depends on SYSTEM
    help
        allow poweroff when no device connected

config AUTO_POWEDOWN_CONNECTED
    bool
    prompt "Poweroff When Device Connected Support"
	depends on SYSTEM
	default n
    help
        allow poweroff when device connected

config AUTO_POWEDOWN_NOPLAYING
    bool
    prompt "Poweroff When Not Playing Support"
	depends on SYSTEM
    help
        allow poweroff when not playing   

config MONITOR_PERIOD
    int "delay how long (second) to monitor running"
	depends on SYSTEM
	default 100
    help
    This option set the time to monitor running

config SYSTEM_SHELL
	bool "System Shell Support"
	depends on SYSTEM
	default n
	select CONSOLE_SHELL
	help
	  This shell provides to  modify system config.

config BTSRV_PRIORITY
    int
    prompt "Bt Service Thread Priority"
    default 4
    depends on BT_SERVICE
    help
    This option set audio thread priority  

config BTSRV_STACKSIZE
    int
    prompt "Bt Service Thread Stack Size"
    depends on BT_SERVICE
    default 2048
    help
    This option set stack size for bt service thread 

config SYS_APP_NAME
	string
	default system

config FRONT_APP_NAME
	string
	default main

config SYS_SOC_UUID
	bool
	prompt "System soc uuid Support"
	depends on SYSTEM
	default n
	help
	This option enables actions system soc uuid.	
    
source "ext/actions/system/power/Kconfig"
source "ext/actions/system/hotplug/Kconfig"
source "ext/actions/system/input/Kconfig"
source "ext/actions/system/tts/Kconfig"
source "ext/actions/system/fs_manager/Kconfig"
source "ext/actions/system/fm/Kconfig"
source "ext/actions/system/act_event/Kconfig"
source "ext/actions/system/serial_flasher/Kconfig"
```

## ext/actions/system/serial_flasher/Kconfig
```kconfig
config SERIAL_FLASHER
	bool
	prompt "serial flasher Support"
	default n
	help
	This option enable or disable serial flasher module

config SERIAL_FLASHER_COMMAND_LETWS_STREAM
	bool "serial flasher command use letws stream or not"
	depends on SERIAL_FLASHER
	default n
	help
	  This option enable or disable letws stream command used in serial flasher

config SERIAL_FLASHER_ON_DEV_NAME
	string "serial flasher device name"
	depends on SERIAL_FLASHER
	default "UART_0"
	help
	  Specify the device name for serial flasher

config SERIAL_FLASHER_BINARY_FILE_PATH
	string "serial flasher path name"
	depends on SERIAL_FLASHER
	default "OTA.bin"
	help
	  Specify the path name for serial flasher
	  
config SERIAL_FLASHER_COMMAND_TIMEOUT
	int "serial flasher command timeout for read"
	depends on SERIAL_FLASHER
	default 3000
	help
	  This option config letws stream command read timeout
```

## ext/fs/fat/Kconfig
```kconfig
config FAT_FILESYSTEM_ELM
	bool "ELM FAT File System"
	depends on FILE_SYSTEM_FAT
	select FAT_FILESYSTEM_ELM_UTF8
	default y
	help
	Use the ELM FAT File system implementation.

config LONG_FILE_NAME
	bool "LONG FILE NAME System"
	depends on FAT_FILESYSTEM_ELM
	default y
	help
	Use the long file name implementation.

config XSFN_OPT
	bool "Short FILE NAME System"
	depends on FAT_FILESYSTEM_ELM
	default y
	help
	Use the short file name implementation.

config CODE_TABLE_IN_SDFS
	bool "code table in sdfs System"
	depends on FAT_FILESYSTEM_ELM
	default n
	help
	Use the code table in sdfs.

config FAT_FILESYSTEM_ELM_UTF8
	bool "UTF8 for ELM FAT File System"
	depends on FAT_FILESYSTEM_ELM
	select NLS
	select NLS_UTF8
	default n
	help
	Use the UTF-8 for ELM FAT File system implementation.

config DISKIO_CACHE
	bool "disk io cache"
	depends on FAT_FILESYSTEM_ELM
	default n
	help
	enable disk io cache.
```
