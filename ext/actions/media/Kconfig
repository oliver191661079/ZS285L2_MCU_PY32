## samples/bt_speaker/src/ota/Kconfig
```kconfig
menuconfig OTA_APP
	bool
	prompt "OTA App Support"
	select OTA_UPGRADE
	default n
	help
	This option enable or disable ota app

config OTA_FOREGROUND
	bool "OTA Foreground Support"
	depends on OTA_APP
	default n
	help
	  This option enable OTA foreground upgrade.

config OTA_BACKGROUND
	bool "OTA background Support"
	depends on OTA_APP
	default n
	help
	  This option enable OTA background upgrade.

config SYSTEM_RECOVERY_APP_SUPPORT
	bool
	prompt "System Recovery App Support"
	depends on OTA_APP
	default n
	depends on SYSTEM_RECOVERY
	help
	This option enable or disable system recovery app

config OTA_UPGRADE
	bool "OTA Upgrade Support"
	default n
	select PARTITION
	select FIRMWARE_VERSION
	help
	  This option enable OTA upgrade.

if OTA_UPGRADE
config OTA_RECOVERY
	bool "OTA recovery firmware Support"
	default n
	depends on OTA_UPGRADE
	help
	  This option enable OTA recovery firmware.

config OTA_RECOVERY_APP
	bool "OTA recovery application Support"
	default n
	depends on OTA_RECOVERY
	help
	  This option enable OTA recovery application.

config OTA_UNLOAD
	bool "OTA recovery firmware unload"
	default n
	depends on OTA_UPGRADE
	help
	  This option enable OTA unload firmware.

config OTA_DOWNLOAD_EXTERNAL_FLASH
	bool "OTA data download external flash or internal flash"
	default n
	depends on OTA_UPGRADE
	help
	  This option enable OTA data download external flash.

config OTA_TEMP_PART_DEV_NAME
	string "OTA temp partition device name"
	depends on OTA_RECOVERY
	default "xspi_nor"
	help
	  Specify the device name for temp partition.

config XSPI1_NOR_ACTS_DEV_NAME
	string "SPI1 NOR flash device name"
	depends on XSPI_NOR_ACTS
	default "spi1_nor"
	help
	  Specify the device name for SPI1 NOR flash driver.

config OTA_BACKEND_DISK
    bool "OTA upgrade by disk"
    default n
    help
      This option enables OTA upgrade by disk, like sdcard or uhost.

config OTA_BACKEND_SDCARD
    bool "OTA upgrade by SDCARD Support"
	depends on OTA_BACKEND_DISK
    select MMC
	select MUTIPLE_VOLUME_MANAGER
	select FILE_STREAM
	select STREAM
	select MMC_SDCARD
    default n
    help
      This option enables OTA upgrade by SDCARD.

config OTA_BACKEND_UHOST
    bool "OTA upgrade by UHOST Support"
    depends on OTA_BACKEND_DISK
	select USB_HOST
	select USB_HOST_STACK
	select USB_HOST_STORAGE
	select MUTIPLE_VOLUME_MANAGER
	select FILE_STREAM
	select STREAM
    default n
    help
      This option enables OTA upgrade by UHOST.

config OTA_BACKEND_BLUETOOTH
    bool "OTA upgrade by Bluetooth Support "
	depends on BT_MANAGER
	select STREAM
    select BT_SPPBLE_STREAM
    default n
    help
      This option enables OTA upgrade by Bluetooth SPP/BLE.

config OTA_BACKEND_TEMP_PART
    bool "OTA upgrade by spinor Support"
    select FLASH
    default n
    help
      This option enables OTA upgrade by spinor.

config OTA_BACKEND_LETWS_STREAM
	bool "Support OTA upgrade by letws stream"
	depends on BT_LETWS
	default n
	help
	  This option enables OTA upgrade by letws stream.

config OTA_FILE_PATCH
    bool "OTA file patch Support"
    depends on !OTA_RECOVERY
    default y
    help
      This option enables OTA file patch.

config OTA_BACKEND_UART
	bool "Support OTA upgrade by uart"
	depends on UART_ACTS
	select UART_STREAM
	default n
	help
	  This option enables OTA upgrade by uart.

config OTA_BACKEND_UART_CDC
	bool "enable cdc uart"
	depends on OTA_BACKEND_UART
	select CDC_UART_STREAM
	default n
	help
	  This option enable/disable CDC UART.

config OTA_APP_AUTO_SWITCH
	bool "OTA app is switched to active automatically."
	default n
	help
	  This option enables automatically ota app switching.

config OTA_TEMP_BIN_NOT_ENCRYPT
	bool "OTA temp.bin not encrypt, only encrypt recovery.bin"
	default n
	help
	  This option enables ota temp.bin not encrypt
endif
```

## samples/bt_speaker/src/tool/Kconfig
```kconfig
# Kconfig - ACTIONS primitive options for sdk version 2.0

#
# Copyright (c) 2023 Actions Semiconductor Co., Ltd
# PDX-License-Identifier: Apache-2.0
#

menuconfig TOOL
	bool "PC Tool Support"
	depends on STUB_DEV_USB
	default n
	help
	This option enables the PC TOOL

config TOOL_STACK_SIZE
	int "PC Tool thread stack size"
	depends on TOOL
	default 1536
	help
	This option configure PC Tool thread stack

config TOOL_ASET
	bool "PC TOOL ASET Support"
	depends on TOOL && MEDIA_SERVICE
	default n
	help
	This option enables the PC TOOL ASET

config TOOL_ASET_PRINT_DEBUG
	bool
	prompt "Tool ASET print debug enable"
	default n
	depends on TOOL_ASET
	help
	This option enables Tool ASET print debug

config TOOL_AUDIO_EFFECT_MUSIC_DRC
	int
	prompt "Audio effect DRC version"
	default 2
	help
	This option config Audio effect DRC version

config TOOL_ASQT
	bool "PC TOOL ASQT Support"
	depends on TOOL && MEDIA_SERVICE
	default n
	select STREAM
	select ZERO_STREAM
	help
	This option enables the PC TOOL ASQT

config TOOL_DUMP
	bool "PC TOOL DUMP Support"
	depends on TOOL && MEDIA_SERVICE
	default n
	select STREAM
	help
	This option enables the PC TOOL DUMP

config TOOL_ECTT
	bool "PC TOOL ECTT Support"
	depends on TOOL && MEDIA_SERVICE
	default n
	help
	This option enables the PC TOOL ECTT

config TOOL_COMMON_DAE
	bool "PC TOOL COMMON DEA Support"
	default n
	depends on TOOL
	help
	This option enables the PC TOOL COMMON DEA

config TOOL_RETT
	bool "PC TOOL RETT Support"
	depends on TOOL && MEDIA_SERVICE
	default n
	help
	This option enables the PC TOOL RETT

config TOOL_PROTOCOL_VERSION
	string "protocal version"
	default "283L201"
	help
	This option config protocal version
```

## samples/bt_speaker/src/usound/Kconfig
```kconfig
# Kconfig - ACTIONS primitive options for sdk version 2.0

#
# Copyright (c) 2023 Actions Semiconductor Co., Ltd
# SPDX-License-Identifier: Apache-2.0
#

config USOUND_APP
	bool
	prompt "USOUND App Support"
	depends on USB_AUDIO_SOURCESINK && USB_DEVICE_HID
	depends on  MEDIA_PLAYER
	select STREAM
	select RINGBUFF_STREAM
	default n
	help
	This option enables or disable the usb audio app.

config USOUND_SPEAKER
	bool
	prompt "USOUND IN"
	depends on USOUND_APP
	default n
	help
	This option enables or disable the usb audio in.

config USOUND_MIC
	bool
	prompt "USOUND OUT"
	depends on USOUND_APP
	select SUPPORT_USB_AUDIO_SOURCE
	default n
	help
	This option enables or disable the usb audio out.
```

## subsys/debug/poweroff_simulator/Kconfig
```kconfig
# Copyright (c) 2020 Intel Corporation.
# SPDX-License-Identifier: Apache-2.0

config POWEROFF_SIMULATOR
	bool
	prompt "poweroff simulator"
	default n
	help
	  This option enable poweroff simulator support.

config POWEROFF_SIMULATOR_OTA
	bool
	prompt "poweroff simulator ota "
	default n
	help
	  This option enable poweroff simulator of ota module support.

config POWEROFF_SIMULATOR_NVRAM
	bool
	prompt "poweroff simulator NVRAM "
	default n
	help
	  This option enable poweroff simulator of NVRAM module support.

config POWEROFF_SIMULATOR_PROPERTY
	bool
	prompt "poweroff simulator property "
	default n
	help
	  This option enable poweroff simulator of property module support.
```

## subsys/disk/Kconfig
```kconfig
#
# Copyright (c) 2016 Intel Corporation
#
# SPDX-License-Identifier: Apache-2.0
#

menu "Disk"

config DISK_ACCESS
	bool
	default n
	prompt "Enable Disk Interface"
	help
	Enable disk access over a supported media backend like FLASH or RAM

if DISK_ACCESS

config DISK_ACCESS_USB
	bool "usb disk"
	depends on USB_HOST_STORAGE
	default n
	help
	usb disk is used for the file system.

config DISK_ACCESS_SD
	bool "sdcard disk"
	depends on MMC
	default n
	help
	sdcard disk is used for the file system.

config DISK_ACCESS_RAM
	bool "RAM Disk"
	default n
	help
	RAM buffer used to emulate storage disk.
	This option can used to test the file
	system.

config DISK_ACCESS_FLASH
	bool "Flash"
	select FLASH
	default n
	help
	Flash device is used for the file system.

config DISK_ACCESS_NOR
	bool "Nor DISK"
	select FLASH
	default n
	help
	Nor disk device is used for the file system.

config DISK_ACCESS_PSRAM
	bool "PSRAM Disk"
	depends on SPI_PSRAM
	default n
	help
	PSRAM disk device is used for the file system.

if DISK_ACCESS_NOR

config DISK_NOR_DEV_NAME
	string
	prompt "Flash device name to be used as storage backend"

config DISK_NOR_START
	hex "Start offset in the NOR"
	default 0xffffffff
	help
	This is start address of the flash to be used as storage backend.

config DISK_NOR_VOLUME_SIZE
	hex "NOR disk Volume size"
	default 0x0
	help
	This is the file system volume size in bytes.

endif # DISK_ACCESS_NOR

if DISK_ACCESS_PSRAM

config DISK_PSRAM_START
	hex "Start offset in the PSRAM"
	default 0x0
	help
	This is start address of the psram to be used as storage backend.

config DISK_PSRAM_VOLUME_SIZE
	hex "PSRAM disk Volume size"
	default 0x200000
	help
	This is the file system volume size in bytes.

endif # DISK_ACCESS_PSRAM

if DISK_ACCESS_FLASH

config DISK_FLASH_DEV_NAME
	string
	prompt "Flash device name to be used as storage backend"

config DISK_FLASH_START
	hex
	prompt "Flash address start to be used as storage backend"
	default 0xffffffff
	help
	This is start address of the flash to be used as storage backend.

config DISK_FLASH_MAX_RW_SIZE
	hex
	prompt "FLASH maximum number of bytes to flash_write per invocation"
	help
	This is the maximum number of bytes that the
	flash_write API can do per invocation.
	API.

config DISK_FLASH_ERASE_ALIGNMENT
	hex
	prompt "Flash erase start address alignment"
	help
	This is the start address alignment required by
	the flash component.

config DISK_ERASE_BLOCK_SIZE
	hex
	prompt "FLASH minimum block size to be erased"
	help
	This is typically the minimum block size that
	is erased at one time in flash storage.

config DISK_VOLUME_SIZE
	hex
	prompt "FLASH file system volume size in bytes"
	default 0x0
	help
	This is the file system volume size in bytes.

endif # DISK_ACCESS_FLASH

endif # DISK_ACCESS
endmenu
```
