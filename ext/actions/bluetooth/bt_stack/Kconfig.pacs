## ext/actions/bluetooth/bt_stack/Kconfig.pacs
```kconfig
# Bluetooth Audio - Published Audio Capabilities Service options
#
# Copyright (c) 2021 Actions Corporation
#
# SPDX-License-Identifier: Apache-2.0
#

if BT_AUDIO

config BT_PACS
	bool "Published Audio Capabilities Service Support"
	default n
	help
	  This option enables support for Published Audio Capabilities Service.

if BT_PACS

config BT_PACS_BUF_SIZE
	int "Buffer size of each PACS instance"
	default 32
	help
	  Sets the buffer size of Published Audio Capabilities Service (PACS)
	  instance.

config BT_DEBUG_PACS
	bool "Published Audio Capabilities Service debug"
	depends on BT_AUDIO_DEBUG
	help
	  Use this option to enable Published Audio Capabilities Service debug
	  logs for the Bluetooth Audio functionality.

endif # BT_PACS

config BT_PACS_CLIENT
	bool "Published Audio Capabilities Profile Support"
	select BT_GATT_CLIENT
	default n
	help
	  This option enables support for Published Audio Capabilities Profile.

if BT_PACS_CLIENT

config BT_DEBUG_PACS_CLIENT
	bool "Published Audio Capabilities Service client debug"
	depends on BT_AUDIO_DEBUG
	help
	  Use this option to enable Published Audio Capabilities Service client
	  debug logs for the Bluetooth Audio functionality.

endif # BT_PACS_CLIENT

endif # BT_AUDIO
```

## ext/actions/bluetooth/bt_stack/Kconfig.tbs
```kconfig
# Bluetooth Audio - Telephone Bearer Service options
#
# Copyright (c) 2021 Actions Corporation
#
# SPDX-License-Identifier: Apache-2.0
#

if BT_AUDIO

config BT_TBS
	bool "Telephone Bearer Service Support"
	default n
	help
	  This option enables support for Telephone Bearer Service.

if BT_TBS

config BT_DEBUG_TBS
	bool "Telephone Bearer Service debug"
	depends on BT_AUDIO_DEBUG
	help
	  Use this option to enable Telephone Bearer Service debug logs for the
	  Bluetooth Audio functionality.

endif # BT_TBS

config BT_TBS_CLIENT
	bool "Telephone Bearer Profile Support"
	select BT_GATT_CLIENT
	default n
	help
	  This option enables support for Telephone Bearer Profile.

if BT_TBS_CLIENT

config BT_DEBUG_TBS_CLIENT
	bool "Telephone Bearer Profile debug"
	depends on BT_AUDIO_DEBUG
	help
	  Use this option to enable Telephone Bearer Profile debug logs for the
	  Bluetooth Audio functionality.

endif # BT_TBS_CLIENT

endif # BT_AUDIO
```

## ext/actions/bluetooth/bt_stack/Kconfig.tmas
```kconfig
# Bluetooth Audio - Telephony and Media Audio Service options
#
# Copyright (c) 2021 Actions Corporation
#
# SPDX-License-Identifier: Apache-2.0
#

if BT_AUDIO

config BT_TMAS
	bool "Telephony and Media Audio Service Support"
	default n
	help
	  This option enables support for Telephony and Media Audio Service.

config BT_TMAS_CLIENT
	bool "Telephony and Media Audio Profile Support"
	select BT_GATT_CLIENT
	default n
	help
	  This option enables support for Telephony and Media Audio Profile.

endif # BT_AUDIO
```

## ext/actions/bluetooth/bt_stack/services/Kconfig
```kconfig
# GATT Services

# Copyright (c) 2018 Nordic Semiconductor ASA
# SPDX-License-Identifier: Apache-2.0

menu "GATT Services"
	depends on BT_CONN

source "ext/actions/bluetooth/bt_stack/services/Kconfig.dis"

source "ext/actions/bluetooth/bt_stack/services/Kconfig.bas"

source "ext/actions/bluetooth/bt_stack/services/Kconfig.hrs"

source "ext/actions/bluetooth/bt_stack/services/Kconfig.tps"

source "ext/actions/bluetooth/bt_stack/services/Kconfig.hids"

source "ext/actions/bluetooth/bt_stack/services/Kconfig.cts"

source "ext/actions/bluetooth/bt_stack/services/ots/Kconfig"

endmenu
```

## ext/actions/bluetooth/bt_stack/services/Kconfig.cts
```kconfig
# Bluetooth GATT Current Time Service

# Copyright (c) 2018 Nordic Semiconductor ASA
# SPDX-License-Identifier: Apache-2.0

menuconfig BT_CTS
	bool "Enable GATT Current Time Service"
	select SENSOR
```

## ext/actions/display/Kconfig
```kconfig
# Kconfig - Actions system manager

#
# Copyright (c) 2016 Actions Corporation
#
# SPDX-License-Identifier: Apache-2.0
#

menuconfig DISPLAY
	bool
	prompt "Display Support"
	depends on ACTIONS_COMPONENT_FUNCTION
	select UI_MANAGER
	default n
	help
	This option enables actions system manager.

config LED_MANAGER
	bool
	prompt "LED Manager Support"
	depends on LED
	default n
	help
	This option enables actions led manager.

config SEG_LED_MANAGER
	bool
	prompt "SEG LED Manager Support"
	depends on SEG_LED
	default n
	help
	This option enables actions seg led  manager.

config UI_MANAGER
	bool
	prompt "Ui Manager Support"
	default n
	help
	This option enables actions app manager.

config GUI
       bool
       prompt "Gui Support"
	   depends on DISPLAY
       default n
       help
       This option enables actions gui interface

config UGUI
       bool
       prompt "Ugui 0.3 Support"
       depends on GUI
       default n
       help
       This option enables ugui 0.3 interface

config UGUI_TINY_MODE 
       bool
       prompt "Ugui 0.3 tiny Support"
       depends on UGUI
       default n
       help
       This option enables ugui 0.3 support tiny function interface

config UGUI_SIMPLE_MODE 
       bool
       prompt "Ugui 0.3 simple mode Support"
       depends on UGUI
       default n
       help
       This option enables ugui 0.3 support simple function interface

config UGUI_FULL_MODE 
       bool
       prompt "Ugui 0.3 full mode Support"
       depends on UGUI
       default n
       help
       This option enables ugui 0.3 support full function interface

config SUPPORT_GBK_DISPLAY
       bool
       prompt "GBK code display Support"
       depends on UGUI
       default n
       help
       This option enables ugui support GBK code display interface
```

## ext/actions/media/libal/Kconfig
```kconfig
# Kconfig - Actions library

#
# Copyright (c) 2016 Actions Corporation
#
# SPDX-License-Identifier: Apache-2.0
#

menuconfig ACTIONS_LIBRARY
	bool
	prompt "Actions Library Support"
	depends on ACTIONS_SDK
	default n
	help
	  This option enables the Actions library .


menuconfig AUDIO_SYSTEM
	bool
	prompt "audio system Support"
	depends on ACTIONS_LIBRARY
	default n
	select AUDIO
	select AUDIO_IN
	select AUDIO_OUT
	help
	This option enables actions media service. 	
	
menuconfig MEDIA_SERVICE
	bool
	prompt "Media Service Support"
	depends on ACTIONS_LIBRARY
	default n
	select AUDIO_SYSTEM
	select ACTIONS_ALGORITHMS_LIBRARY
	help
	This option enables actions media service.

config MEDIASRV_PRIORITY
    int
    prompt "Media Service Thread Priority"
    default 4
    depends on MEDIA_SERVICE
    help
    This option set audio thread priority  

config MEDIASRV_STACKSIZE
    int
    prompt "Media Service Thread Stack Size"
    default 2048
    depends on MEDIA_SERVICE
    help
    This option set stack size for audio service thread	    
source "ext/actions/media/libal/csky/Kconfig"
```

## ext/actions/media/libal/mips/Kconfig
```kconfig
# Kconfig - Actions library

#
# Copyright (c) 2016 Actions Corporation
#
# SPDX-License-Identifier: Apache-2.0
#

source "ext/actions/library/mips/al/Kconfig"
```

## ext/actions/media/libal/mips/al/Kconfig
```kconfig
# Kconfig - Actions arithmetic library

#
# Copyright (c) 2016 Actions Corporation
#
# SPDX-License-Identifier: Apache-2.0
#

menuconfig ACTIONS_ALGORITHMS_LIBRARY
	bool
	prompt "ACTIONS SDK Algorithms library Support"
	depends on ACTIONS_LIBRARY
	default n
	help
	  This option enables Actions Algorithms library.


menuconfig ACTIONS_DECODER
	bool
	prompt "ACTIONS Decoder Support"
	depends on ACTIONS_ALGORITHMS_LIBRARY
	default n
	help
	  This option enables the  SDK DECODER FUNCTION.

config DECODER_AAC
	bool
	prompt "support aac decoder"
	depends on ACTIONS_DECODER
	default n
	help
	This option enables the aac decoder.

config DECODER_ACT
	bool
	prompt "support actii decoder"
	depends on ACTIONS_DECODER
	default n
	help
	This option enables the actii decoder.

config DECODER_APE
	bool
	prompt "support ape decoder"
	depends on ACTIONS_DECODER
	default n
	help
	This option enables the APE decoder.

config DECODER_CVSD
	bool
	prompt "support cvsd decoder"
	depends on ACTIONS_DECODER
	default n
	help
	This option enables the cvsd decoder.

config DECODER_FLAC
	bool
	prompt "support flac decoder"
	depends on ACTIONS_DECODER
	default n
	help
	This option enables the flac decoder.

config DECODER_MP3
	bool
	prompt "support mp3 decoder "
	depends on ACTIONS_DECODER
	default n
	help
	This option enables the mp3 decoder.

config DECODER_PCM
	bool
	prompt "support pcm convert decoder"
	depends on ACTIONS_DECODER
	default n
	help
	This option enables the pcm convert decoder.

config DECODER_SBC
	bool
	prompt "support sbc decoder"
	depends on ACTIONS_DECODER
	default n
	help
	This option enables the sbc decoder.

config DECODER_SBC_HW_ACCELERATION
	bool
	prompt "support sbc dsp hw acceleration decoder"
	depends on DECODER_SBC
	default n
	help
	This option enables the sbc dsp hw acceleration.

config DECODER_WAV
	bool
	prompt "support wav decoder"
	depends on ACTIONS_DECODER
	default n
	help
	This option enables the  wav decoder.

config DECODER_WAV_HW_ACCELERATION
	bool
	prompt "support wav dsp hw acceleration decoder"
	depends on DECODER_WAV
	default n
	help
	This option enables the wav dsp hw acceleration .

config DECODER_WMA
	bool
	prompt "support wma decoder"
	depends on ACTIONS_DECODER
	default n
	help
	This option enables the wma decoder.


menuconfig ACTIONS_ENCODER
	bool
	prompt "ACTIONS Encoder Support"
	depends on ACTIONS_ALGORITHMS_LIBRARY
	default n
	help
	  This option enables the ENCODER FUNCTION.

config ENCODER_CVSD
	bool
	prompt "support cvsd encoder"
	depends on ACTIONS_ENCODER
	default n
	help
	This option enables the cvsd encoder.

config ENCODER_MP3
	bool
	prompt "support mp3 encoder"
	depends on ACTIONS_ENCODER
	default n
	help
	This option enables the mp3 encoder.

config ENCODER_OPUS
	bool
	prompt "support opus encoder"
	depends on ACTIONS_ENCODER
	default n
	help
	This option enables the opus encoder.

config ENCODER_OPUS_HW_ACCELERATION
	bool
	prompt "support opus dsp hw acceleration decoder"
	depends on ENCODER_OPUS
	default n
	help
	This option enables the opus dsp hw acceleration .

config ENCODER_PCM
	bool
	prompt "support pcm encoder"
	depends on ACTIONS_ENCODER
	default n
	help
	This option enables the PCM encoder.

config ENCODER_SBC
	bool
	prompt "support sbc encoder"
	depends on ACTIONS_ENCODER
	default n
	help
	This option enables the sbc encoder.

config ENCODER_WAV
	bool
	prompt "support wav encoder"
	depends on ACTIONS_ENCODER
	default n
	help
	This option enables the wav encoder.


menuconfig ACTIONS_PARSER
	bool
	prompt "Actions Parser Support"
	depends on ACTIONS_ALGORITHMS_LIBRARY
	default n
	help
	  This option enables the PARSER FUNCTION.

config PARSER_WAV
	bool
	prompt "support wav parser"
	depends on ACTIONS_PARSER
	default n
	help
	This option enables the wav parser.


config HFP_PLC
	bool
	prompt "support hfp plc"
	depends on ACTIONS_ALGORITHMS_LIBRARY
	default n
	help
	This option enables the hfp plc.

config HFP_SPEECH
	bool
	prompt "support hfp speech aec/agc"
	depends on ACTIONS_ALGORITHMS_LIBRARY
	select HFP_PLC
	default n
	help
	This option enables the hfp speech aec/agc.

config HFP_DAE
	bool
	prompt "support hfp dae"
	depends on ACTIONS_ALGORITHMS_LIBRARY
	default n
	help
	This option enables the hfp dae.

config MUSIC_DAE
	bool
	prompt "support music dae"
	depends on ACTIONS_ALGORITHMS_LIBRARY
	default n
	help
	This option enables the music dae.

config MUSIC_DAE_FADE
	bool
	prompt "support music dae fade in/out"
	depends on MUSIC_DAE
	default n
	help
	This option enables the music dae fade in/out.

config AUDIO_MIX
	bool "support audio mixing"
	depends on ACTIONS_ALGORITHMS_LIBRARY
	default n
	help
	This option enables the audio mixing.

config RESAMPLE
	bool
	prompt "support resample"
	depends on ACTIONS_ALGORITHMS_LIBRARY
	default n
	select ACCELERATOR_ACTS
	select ACCELERATOR_ACTS_WOODPECKER
	help
	This option enables the resample.

config OUTPUT_RESAMPLE_SW
	bool
	prompt "resample use hardware"
	default n
	depends on RESAMPLE
	help
	This option consent to use hardware/software resample.

config SF_APS
	bool
	prompt "support software aps "
	depends on ACTIONS_ALGORITHMS_LIBRARY
	default n
	help
	This option enables the software aps.
```

## ext/actions/ota/Kconfig
```kconfig
# Kconfig - Actions ota

#
# Copyright (c) 2016 Actions Corporation
#
# SPDX-License-Identifier: Apache-2.0
#

menuconfig OTA
	bool
	prompt "ota"
	default n
	help
	This option enables actions ota

if OTA
	config OTA_LEGACY_REQ_SIZE
		prompt "ota legacy req size"
		bool
		default n
		help
			Enable this option to support legracy OTA app.

	config OTA_IMAGE_CHECK_MODE
		int "OTA image check mode"
		default 0
		depends on OTA_UPGRADE
		help
			This option set ota image check mode.
endif
```

## ext/actions/porting/Kconfig
```kconfig
# Kconfig - Actions SDK Porting

#
# Copyright (c) 2016 Actions Corporation
#
# SPDX-License-Identifier: Apache-2.0
#

menuconfig ACTIONS_SDK_PORTING
	bool
	prompt "ACTIONS Porting Funcion Support"
	depends on ACTIONS_SDK
	default n
	select OS_WRAPPER
	select ACTIONS_GLOBEL_MEM
	help
	This option enables actions sdk porting function support .

config OS_WRAPPER
	bool
	prompt "os wrapper"
	depends on ACTIONS_SDK_PORTING
	default n
	help
	This option enables actions os wrapper.

config OS_LOW_LATENCY_MODE
	bool
	prompt "os low latency mode"
	depends on OS_WRAPPER
	default n
	help
	This option enables actions os low latency mode.

config MESSAGE_DEBUG
	bool
	prompt "debug os massage"
	depends on OS_WRAPPER
	default n
	help
	This option enables actions debug os massage.

config USER_WORK_Q
	bool
	prompt "support user work queue , low priporty then system work queue"
	depends on OS_WRAPPER
	default n
	help
	This option enables actions user work queue.

config USER_WORK_Q_STACK_SIZE
	int
	prompt "user work queue stack size"
	depends on USER_WORK_Q
	default 1152
	help
	This option set user work queue stack size.

config USER_WORK_Q_PRIORITY
	int
	prompt "user work queue thread priority"
	depends on USER_WORK_Q
	default 1
	help
	This option set user work queue thread priority.

config MSG_SEND_TIME_STAT
	bool
	prompt "Message Manager Send time statistics"
	depends on OS_WRAPPER
	default n
	help
	This option enables actions message manager send time statistics.

config MSG_SEND_TIME_LATENCY_MS
    int "max msg send latency time"
    default 100
	depends on OS_WRAPPER
    help
     monitor msg send time latency

config MSG_RECV_TIME_STAT
	bool
	prompt "Message Manager recv time statistics"
	depends on OS_WRAPPER
	default n
	help
	This option enables actions message manager recv time statistics.

config MSG_RECV_TIME_LATENCY_MS
    int "max msg recv latency time"
    default 100
	depends on OS_WRAPPER
    help
     monitor msg recv time latency

source "ext/actions/porting/hal/Kconfig"
```
