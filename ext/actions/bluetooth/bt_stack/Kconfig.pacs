## ext/actions/porting/hal/Kconfig
```kconfig
# Kconfig - ACTIONS primitive options for sdk version 2.0

#
# Copyright (c) 2015 Intel Corporation
#
# Licensed under the Apache License, Version 2.0 (the "License");
# you may not use this file except in compliance with the License.
# You may obtain a copy of the License at
#
#     http://www.apache.org/licenses/LICENSE-2.0
#
# Unless required by applicable law or agreed to in writing, software
# distributed under the License is distributed on an "AS IS" BASIS,
# WITHOUT WARRANTIES OR CONDITIONS OF ANY KIND, either express or implied.
# See the License for the specific language governing permissions and
# limitations under the License.
#
config AUDIO_IN
	bool
	prompt "Audio In Hal Support"
	depends on ACTIONS_SDK_PORTING
	select AUDIO
	select AUDIO_IN_ACTS
	default n
	help
	This option enables actions audio in hal.

config AUDIO_IN_STEREO
	bool
	prompt "stereo support "
	depends on AUDIO_IN
	default n
	help
	This option enables actions audio stereo

config STEREOPHONIC_MONO
	bool
	prompt "stereo phonic mono support "
	depends on AUDIO_IN
	default n
	help
	This option enables actions audio stereo phonic mono

config AUDIO_OUT
	bool
	prompt "Audio Out Hal Support"
	depends on ACTIONS_SDK_PORTING
	select AUDIO
	select AUDIO_OUT_ACTS
	default n
	help
	This option enables actions audio out hal.

config DISPLAY
	bool
	prompt "Display Hal Support"
	depends on ACTIONS_SDK_PORTING
	default n
	help
	This option enables actions display hal

config LED
	bool
	prompt "Led Hal Support"
	depends on ACTIONS_SDK_PORTING
	select ACTS_LED_DISPLAY
	select LED_MANAGER
	default n
	help
	This option enables actions led hal

config SEG_LED
	bool
	prompt "Led Hal Support"
	depends on ACTIONS_SDK_PORTING
	select SEG_LED_DISPLAY
	select SEG_LED_MANAGER
	default n
	help
	This option enables actions led hal

config KEY
	bool
	prompt "Key Hal Support"
	depends on ACTIONS_SDK_PORTING
	default n
	help
	This option enables actions key hal

config DSP
	bool
	prompt "Dsp Hal Support"
	depends on ACTIONS_SDK_PORTING
	default n
	select ACTS_RING_BUFFER
	help
	This option enables actions dsp hal

config ALARM_CLOCK
	bool
	prompt "Alarm Hal Support"
	depends on ACTIONS_SDK_PORTING
	default n
	help
	This option enables actions alarm clock hal support.

config PSRAM
	bool
	prompt "psram as block device support"
	depends on ACTIONS_SDK_PORTING && SPI_PSRAM
	default n
	help
	This option enables actions psram as block device.

config CACHE
	bool
	prompt "Cache Hal support"
	depends on ACTIONS_SDK_PORTING
	default n
	help
	This option enables actions cache support.

config FILE_CACHE
	bool
	prompt "File Cache Hal support"
	depends on CACHE
	default n
	help
	This option enables actions file cache support.

config RAM_CACHE
	bool
	prompt "Ram Cache Hal support"
	depends on CACHE
	default n
	help
	This option enables actions ram cache support.

config PSRAM_CACHE
	bool
	prompt "Psram Cache Hal support"
	depends on CACHE && PSRAM
	default n
	help
	This option enables actions psram cache support.

config STUB
	bool
	prompt "STUB Hal support"
	depends on ACTIONS_SDK_PORTING
	default y
	help
	This option enables actions stub hal.
    
config AUDIO_USOUND
	bool
	prompt "Usound Hal Support"
	depends on ACTIONS_SDK_PORTING
	default n
	help
	This option enables actions audio usound hal. 
  
source "ext/actions/porting/hal/bluetooth/Kconfig"

source "ext/actions/porting/hal/usb_audio/Kconfig"
```

## ext/actions/porting/hal/bluetooth/Kconfig
```kconfig
# Kconfig - ACTIONS primitive options for sdk version 2.0

#
# Copyright (c) 2015 Intel Corporation
#
# Licensed under the Apache License, Version 2.0 (the "License");
# you may not use this file except in compliance with the License.
# You may obtain a copy of the License at
#
#     http://www.apache.org/licenses/LICENSE-2.0
#
# Unless required by applicable law or agreed to in writing, software
# distributed under the License is distributed on an "AS IS" BASIS,
# WITHOUT WARRANTIES OR CONDITIONS OF ANY KIND, either express or implied.
# See the License for the specific language governing permissions and
# limitations under the License.
#

menuconfig BLUETOOTH_PORTING
	bool
	prompt "Bluetooth Porting support"
	depends on ACTIONS_SDK_PORTING
	default n
	select BT_DRV
	help
	This option enables actions bluetooth funcion.
	
config BT_DRV
	bool
	prompt "bluetooth controller driver (BLE/BR/EDR) Support"
	depends on BLUETOOTH_PORTING
	default n
	help
	This option enables the actions bluetooth controller driver (BLE/BR/EDR).

config BT_TEST_MODE
	bool
	prompt "bluetooth rf test mode"
	depends on BT_DRV
	default n
	help
	This option enables the actions bluetooth rf test mode.

config CONTROLLER_HIGH_PRIORITY	
    int
    prompt "bt controller high thread priority"
	depends on BT_DRV
    default -15
    help
    This option set bt controller high thread priority

config CONTROLLER_HIGH_STACKSIZE 
    int
    prompt "bt controller high thread stacksize"
	depends on BT_DRV
    default 2048
    help
    This option set bt controller high thread stacksize 

source "ext/actions/porting/hal/bluetooth/bt_drv/Kconfig"


 
```

## ext/actions/porting/hal/usb_audio/Kconfig
```kconfig
# Kconfig - ACTIONS primitive options for sdk version 2.0

#
# Copyright (c) 2015 Intel Corporation
#
# Licensed under the Apache License, Version 2.0 (the "License");
# you may not use this file except in compliance with the License.
# You may obtain a copy of the License at
#
#     http://www.apache.org/licenses/LICENSE-2.0
#
# Unless required by applicable law or agreed to in writing, software
# distributed under the License is distributed on an "AS IS" BASIS,
# WITHOUT WARRANTIES OR CONDITIONS OF ANY KIND, either express or implied.
# See the License for the specific language governing permissions and
# limitations under the License.
#
config USB_APP_AUDIO_DEVICE_MANUFACTURER
	string
	prompt "USB audio(composite device) manufacturer name"
	default "ZEPHYR"
	help
	  USB audio device manufacturer string. can be configured by vendor.

config USB_APP_AUDIO_DEVICE_PRODUCT
	string
	prompt "USB AUDIO device product name"
	default "USB-AUDIO-DEV"
	help
	  USB audio device product string. can be configured by vendor.

config USB_APP_AUDIO_DEVICE_SN
	string
	prompt "USB audio device serial number"
	default "0123456789AB"
	help
	  USB audio device serial number string. can be configured by vendor.

config USB_APP_AUDIO_DEVICE_VID
	hex
	prompt "USB audio device vendor ID"
	default 0x10d6
	help
	  USB audio device vendor ID. MUST be configured by vendor.

config USB_APP_AUDIO_DEVICE_PID
	hex
	prompt "USB audio device product ID"
	default 0xb00d
	help
	  USB audio device product ID. MUST be configured by vendor.
```

## ext/actions/system/act_event/Kconfig
```kconfig
# Kconfig - Actions system manager

#
# Copyright (c) 2016 Actions Corporation
#
# SPDX-License-Identifier: Apache-2.0
#

menuconfig ACT_EVENT
	bool
	prompt "ActEvent"
	default n
	help
	This option enables actions event system


config ACT_EVENT_COMPILE_LEVEL
	int "Default act_event compile level"
	default 3
	range 0 4
	depends on ACT_EVENT
	help
	  Sets log level for modules which don't specify it explicitly. When
	  set to 0 it means log will not be activated for those modules.
	  Levels are:

	  - 0 OFF, do not write by default
	  - 1 ERROR, default to only write LOG_LEVEL_ERR
	  - 2 WARNING, default to write LOG_LEVEL_WRN
	  - 3 INFO, default to write LOG_LEVEL_INFO
	  - 4 DEBUG, default to write LOG_LEVEL_DBG	

config ACT_EVENT_COMPILE_MODUL_LEVEL
	bool "Enable act_event compile by module level"
	default n
	depends on ACT_EVENT
	help
	  Enable act_event compile by module level or not  

config ACT_EVENT_OUTPUT_USER
	bool "Enable act_event output to user-defined flow"
	default n
	depends on ACT_EVENT
	help
	  Enable act_event output to user-defined flow


config DEBUG_ACT_EVENT_SHELL  
	bool "Enable act_event shell to dump act_event"
	default n
	depends on ACT_EVENT
	help
	  Enable act_event shell to dump act_event

config ACT_EVENT_FLASH_CACHE_SIZE
	int "Default act_event flash cache size"
	default 256
	depends on ACT_EVENT
	help
		Default act_event flash cache size

config ACT_EVENT_LINEBUF_SIZE
	int "Default act_event line buf size"
	default 256
	depends on ACT_EVENT
	help
		Default act_event line buf size				

config ACT_EVENT_PRINT_DROP_COUNT
	bool "Enable act_event output drop count"
	default n
	depends on ACT_EVENT
	help
	  Enable act_event output drop count	 

config ACT_EVENT_DATA_CLEAR
	bool "Enable act_event data clear when poweron/poweroff"
	default n
	depends on ACT_EVENT
	help
	  Enable act_event data clear when poweron/poweroff

config ACT_EVENT_DATA_FULL_MERGE
	bool "Enable act_event data merge when full"
	default n
	depends on ACT_EVENT
	help
	  Enable act_event data full merge  

source "ext/actions/system/act_event/Kconfig.module"
```

## ext/actions/system/act_event/Kconfig.module
```kconfig
config ACT_EVENT_APP_COMPILE_LEVEL
	int "Default act_event app compile level"
	default 3
	range 0 4
	help
	  Sets log level for modules which don't specify it explicitly. When
	  set to 0 it means log will not be activated for those modules.
	  Levels are:

	  - 0 OFF, do not write by default
	  - 1 ERROR, default to only write LOG_LEVEL_ERR
	  - 2 WARNING, default to write LOG_LEVEL_WRN
	  - 3 INFO, default to write LOG_LEVEL_INFO
	  - 4 DEBUG, default to write LOG_LEVEL_DBG	

config ACT_EVENT_MEDIA_COMPILE_LEVEL
	int "Default act_event media compile level"
	default 3
	range 0 4

config ACT_EVENT_BR_COMPILE_LEVEL
	int "Default act_event media compile level"
	default 3
	range 0 4

config ACT_EVENT_BIS_COMPILE_LEVEL
	int "Default act_event media compile level"
	default 3
	range 0 4  

config ACT_EVENT_OS_COMPILE_LEVEL
	int "Default act_event media compile level"
	default 3
	range 0 4      
```

## ext/actions/system/fm/Kconfig
```kconfig
# Kconfig - Actions file system

#
# Copyright (c) 2016 Actions Corporation
#
# SPDX-License-Identifier: Apache-2.0
#

config FM
	bool
	prompt "FM Manager"
	default n
	help
	This option enables actions FM manager
```

## ext/actions/system/fs_manager/Kconfig
```kconfig
# Kconfig - Actions file system

#
# Copyright (c) 2016 Actions Corporation
#
# SPDX-License-Identifier: Apache-2.0
#

menuconfig MUTIPLE_VOLUME_MANAGER
	bool
	prompt "Mutiple Volume Manager"
	select FS_MANAGER
	default n
	help
	This option enables actions filesystem


config FS_MANAGER
	bool
	prompt "FS Manager"
	depends on MUTIPLE_VOLUME_MANAGER
	select FILE_SYSTEM
	select FILE_SYSTEM_FAT
	default n
	help
	This option enables actions mutiple volume manager
```

## ext/actions/system/input/Kconfig
```kconfig
# Kconfig - Actions input menager

#
# Copyright (c) 2016 Actions Corporation
#
# SPDX-License-Identifier: Apache-2.0
#

menuconfig INPUT
	bool
	prompt "Input"
	select INPUT_MANAGER
	default n
	help
	This option enables actions input 
	
config INPUT_MANAGER
	bool
	prompt "INPUT manager Support"
	depends on INPUT
	select KEY
	default n
	help
	This option enables actions input manager.

config INPUT_MUTIPLE_CLICK
	bool
	prompt "INPUT mutiple click Support"
	depends on INPUT_MANAGER
	default n
	help
	This option enables actions input manager.
```

## ext/actions/usb/host/Kconfig
```kconfig
# Kconfig - USB host class drivers configuration options

#
# Copyright (c) 2020 Actions Corporation.
#
# SPDX-License-Identifier: Apache-2.0
#

if USB_HOST_STACK

source "ext/actions/usb/host/storage/Kconfig"

endif # USB_HOST_STACK
```

## ext/fs/sdfs/Kconfig
```kconfig
config SD_FS
	bool "SD File System"
	default n
	select PARTITION
	help
	Use the SD File system implementation.

config SD_FS_VADDR_START
	hex "SD File System start mapping addr "
	depends on SD_FS
	help
	Use SD File System start mapping addr.
```

## ext/hal/csky/csi/Kconfig
```kconfig
# Kconfig - CSKY Core Peripheral Access Layer config
#
# Copyright (C) 2017 C-SKY Microsystems Co., Ltd. All rights reserved.
#
# SPDX-License-Identifier: Apache-2.0
#

config HAS_CSKY_CSI
    bool
    depends on CSKY
```

## samples/bt_speaker/src/demo/Kconfig
```kconfig
# Kconfig - ACTIONS primitive options for sdk version 2.0

#
# Copyright (c) 2023 Actions Semiconductor Co., Ltd
# SPDX-License-Identifier: Apache-2.0
#

config DEMO_APP
	bool
	prompt "Demo(USOUND) App Support"
	default n
	help
	This option enables or disable the demo(usb audio) app.
```

## subsys/Kconfig
```kconfig
# Kconfig - Subsystem configuration options
#
# Copyright (c) 2016-2017 Intel Corporation
#
# SPDX-License-Identifier: Apache-2.0
#

#source "subsys/bluetooth/Kconfig"

source "subsys/console/Kconfig"

source "subsys/cpp/Kconfig"

source "subsys/debug/Kconfig"

source "subsys/disk/Kconfig"

source "subsys/fs/Kconfig"

source "subsys/logging/Kconfig"

source "subsys/net/Kconfig"

source "subsys/recovery/Kconfig"

source "subsys/shell/Kconfig"

source "subsys/btstack/Kconfig"

source "subsys/partition/Kconfig"

source "subsys/fw_version/Kconfig"
```

## subsys/debug/ramdump/Kconfig
```kconfig
# Copyright (c) 2020 Intel Corporation.
# SPDX-License-Identifier: Apache-2.0

config DEBUG_RAMDUMP
	bool
	prompt "Dump ram to flash"
	default n
	help
	  This option enable ram dump support.

choice
	prompt "ramdump compress function"
	default DEBUG_RAMDUMP_COMPRESS_USE_FASTLZ

config DEBUG_RAMDUMP_COMPRESS_USE_LZ4
	bool "ramdump compress use lz4"
	depends on DEBUG_RAMDUMP
	help
	  This option enable ram dump use lz4.

config DEBUG_RAMDUMP_COMPRESS_USE_FASTLZ
	bool "ramdump compress use fastlz"
	depends on DEBUG_RAMDUMP
	help
	  This option enable ram dump use fastlz.

endchoice
```
