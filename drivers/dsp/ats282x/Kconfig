## ext/actions/bluetooth/bt_stack/Kconfig.mcs
```kconfig
# Bluetooth Audio - Media control configuration options
#
# SPDX-License-Identifier: Apache-2.0
#

if BT_AUDIO

##################### Media Control Service #####################

config BT_MCS_MAX_INSTANCE_COUNT
    int "Media Control Service max instance count"
    default 0
    range 0 15
    help
      This option sets the maximum number of instances of Media
      Control Service.

config BT_MCS
	bool "Media Control Service Support"
	default n
	help
	  This option enables support for Media Control Service.

if BT_MCS

config BT_MCS_MAX_MEDIA_PLAYER_NAME_SIZE
	int "Media Control Service max media player name size"
	default 32
	range 0 512
	help
	  This option sets the maximum media player name size in octets.

config BT_MCS_MAX_TRACK_TITLE_SIZE
	int "Media Control Service max track title size"
	default 32
	range 0 512
	help
	  This option sets the maximum media player name size in octets.

config BT_DEBUG_MCS
	bool "Media Control Service debug"
	depends on BT_AUDIO_DEBUG
	help
	  Use this option to enable Media Control Service debug logs for the
	  Bluetooth Audio functionality.

endif # BT_MCS

##################### Media Control Profile Client #####################

config BT_MCS_CLIENT_MAX_INSTANCE_COUNT
    int "Media Control Service client max instance count"
    default 0
    range 0 15
    help
      This option sets the maximum number of instances of Media
      Control Service.

config BT_MCS_CLIENT
	bool "Media Control Client Support"
	default n
	help
	  This option enables support for Media Control Profile.

if BT_MCS_CLIENT

config BT_DEBUG_MCS_CLIENT
	bool "Media Control Profile debug"
	depends on BT_AUDIO_DEBUG
	help
	  Use this option to enable Media Control Profile debug logs for the
	  Bluetooth Audio functionality.

endif # BT_MCS_CLIENT

endif # BT_AUDIO
```

## ext/actions/bluetooth/bt_stack/Kconfig.mics
```kconfig
# Bluetooth Audio - Microphone control configuration options
#
# SPDX-License-Identifier: Apache-2.0
#

if BT_AUDIO

##################### Microphone Control Service #####################

config BT_MICS
	bool "Microphone Control Service Support"
	default n
	help
	  This option enables support for Microphone Control Service.

#if BT_MICS

config BT_MICS_AICS_INSTANCE_COUNT
	int "Audio Input Control Service instance count for MICS"
	default 0
	range 0 BT_AICS_MAX_INSTANCE_COUNT
	help
	  This option sets the number of instances of Audio Input Control
	  Services for MICS.

config BT_DEBUG_MICS
	bool "Microphone Control Service debug"
	depends on BT_AUDIO_DEBUG
	help
	  Use this option to enable Microphone Control Service debug logs for the
	  Bluetooth Audio functionality.

#endif # BT_MICS

##################### Microphone Control Profile Client #####################

config BT_MICS_CLIENT
	bool "Microphone Control Profile Support"
	select BT_GATT_CLIENT
	default n
	help
	  This option enables support for Microphone Control Profile.

#if BT_MICS_CLIENT

config BT_MICS_CLIENT_MAX_AICS_INST
	int "Maximum number of AICS instances to setup"
	default 0
	range 0 BT_AICS_CLIENT_MAX_INSTANCE_COUNT
	help
	  Sets the maximum number of Audio Input Control Service (AICS)
	  instances to setup and use.

config BT_DEBUG_MICS_CLIENT
	bool "Microphone Control Profile debug"
	depends on BT_AUDIO_DEBUG
	help
	  Use this option to enable Microphone Control Profile debug logs for the
	  Bluetooth Audio functionality.

#endif # BT_MICS_CLIENT

endif # BT_AUDIO
```
