## drivers/rtc/Kconfig
```kconfig
# Kconfig - RTC configuration options
#
#
# Copyright (c) 2015 Intel Corporation
#
# SPDX-License-Identifier: Apache-2.0
#

#
# Real-Time Clock (RTC) options
#
menuconfig RTC
	bool "Real-Time Clock"
	default n
	help
	Enable options for Real-Time Clock drivers.

if RTC


config RTC_QMSI
	bool "QMSI RTC Driver"
	depends on QMSI
	default n
	help
	Build QMSI RTC driver.

config RTC_0_NAME
	string "Driver instance name"
	default "RTC_0"
	depends on RTC
	help
	RTC driver instance name

config RTC_0_IRQ_PRI
	int "RTC Driver Interrupt priority"
	depends on RTC
	default 0
	help
	RTC interrupt priority.

config RTC_QMSI_API_REENTRANCY
	bool
	prompt "RTC shim driver API reentrancy"
	default n
	help
	Enable support for RTC shim driver API reentrancy.

config RTC_PCF8563
	bool "PCF8563 RTC Driver"
	default n
	help
	Build PCF8563 RTC driver.

config RTC_PCF8563_I2C_NAME
	string "I2C device name"
	depends on RTC_PCF8563
	default "I2C_0"

config RTC_ACTS
	bool "Actions SoC RTC Driver"
	depends on SOC_FAMILY_ACTS
	default n
	help
	Build Actions SoC RTC driver.

endif # RTC
```

## drivers/sbc_encoder/Kconfig
```kconfig
# Kconfig - RTC configuration options
#
#
# Copyright (c) 2015 Intel Corporation
#
# SPDX-License-Identifier: Apache-2.0
#

#
# SBC encoder driver options
#
config SBC_ENCODER
	bool "sbc encoder driver"
	default n
	help
	Enable options for sbc encoder driver

config SBC_ENCODER_USE_GLOBAL_MEM
    bool "sbc encoder use global memory"
    default n
    help
    Enable options for sbc encoder driver use global memory
```

## drivers/spi/Kconfig.acts
```kconfig
# Kconfig - SPI configuration options
#
# Copyright (c) 2017 Actions Semiconductor Co., Ltd
#
# SPDX-License-Identifier: Apache-2.0
#

menuconfig SPI_ACTS
	bool "Enable DMA driver for Actions SoC"
	depends on SPI && SOC_FAMILY_ACTS
	default n
	help
	  Enable support for Actions SoC SPI driver.

if SPI_ACTS

config SPI_ACTS_DMA
	bool "Support DMA transfer for SPI driver"
	depends on SPI_ACTS
	default n
	help
	  Support DMA transfer for SPI driver.

config SPI_1_ACTS_DMA
	bool "DMA transfer channel for SPI1 full duplex transfer"
	depends on SPI_ACTS_DMA && SPI_1
	default n
	help
	  Support DMA transfer for SPI1 full duplex transfer, need use
	  two dma channel.

config SPI_1_ACTS_DMA_DUPLEX
	bool "DMA transfer channel for SPI1 full duplex transfer"
	depends on SPI_1_ACTS_DMA && SPI_1
	default n
	help
	  Support DMA transfer for SPI1 full duplex transfer, need use
	  two dma channel.

config SPI_1_ACTS_DELAY_CHAIN
	int "SPI delaychain config for SPI1 transfer"
	depends on SPI_ACTS && SPI_1
	default 8
	help
	  SPI delaychain config for SPI1 transfer.

config SPI_2_ACTS_DMA
	bool "DMA transfer channel for SPI1 full duplex transfer"
	depends on SPI_ACTS_DMA && SPI_2
	default n
	help
	  Support DMA transfer for SPI2 full duplex transfer, need use
	  two dma channel.

config SPI_2_ACTS_DMA_DUPLEX
	bool "DMA transfer channel for SPI1 full duplex transfer"
	depends on SPI_2_ACTS_DMA && SPI_2
	default n
	help
	  Support DMA transfer for SPI2 full duplex transfer, need use
	  two dma channel.

config SPI_2_ACTS_DELAY_CHAIN
	int "SPI delaychain config for SPI1 transfer"
	depends on SPI_ACTS && SPI_2
	default 8
	help
	  SPI delaychain config for SPI2 transfer.

endif # SPI_ACTS
```

## drivers/spidev/Kconfig
```kconfig
# Kconfig - DSP device configuration options
#
#
# Copyright (c) 2018 Actions Semiconductor Co., Ltd
#
# SPDX-License-Identifier: Apache-2.0
#

#
# SPIDEV options
#
config SPIDEV_ACTS
	bool
	prompt "SPIDEV driver Configuration"
	default n

config SOC_PSRAM_DCACHE
    bool "Enable PSRAM dcache"
    default n
    help
      Enable PSRAM dcache for Andes SoC
      
config SOC_PSRAM_CPU
    bool "Enable PSRAM cpu"
    default n
    help
      Enable PSRAM dcache for Andes SoC      
```

## drivers/stub/Kconfig
```kconfig
# Kconfig - STUB device configuration options
#
#
# Copyright (c) 2017 Actions Semiconductor Co., Ltd
#
# SPDX-License-Identifier: Apache-2.0
#

menuconfig STUB_DEV
	bool
	prompt "STUB device drivers"
	default n
	help
	  Enable STUB device driver configuration

if STUB_DEV
config SYS_LOG_STUB_DEV_LEVEL
	int
	prompt "STUB Device drivers log level"
	depends on SYS_LOG
	range 0 4
	default 0
	help
	  Sets log level for INPUT Device driver.

	  Levels are:
	  - 0 OFF, do not write
	  - 1 ERROR, only write SYS_LOG_ERR
	  - 2 WARNING, write SYS_LOG_WRN in addition to previous level
	  - 3 INFO, write SYS_LOG_INF in addition to previous levels
	  - 4 DEBUG, write SYS_LOG_DBG in addition to previous levels

config STUB_DEV_USB
	bool "Actions STUB_USB driver"
	depends on SOC_FAMILY_ACTS
	default n
	help
	  Enable support for Actions SoC stub usb driver.

config STUB_DEV_USB_NAME
	string "Device Name for Actions STUB_USB"
	depends on SOC_FAMILY_ACTS
	default "stub_usb"
	help
	  Device name for Actions STUB_DEV_USB.

config STUB_DEV_UART
	bool "Actions STUB_UART driver"
	depends on SOC_FAMILY_ACTS
	depends on UART_ACTS
	default n
	help
	  Enable support for Actions SoC stub uart driver.

config STUB_DEV_UART_NAME
	string "Device Name for Actions STUB_UART"
	depends on SOC_FAMILY_ACTS
	default "stub_uart"
	help
	  Device name for Actions STUB_DEV_UART.

endif # STUB_DEV
```

## drivers/usb/Kconfig
```kconfig
# Kconfig - USB configuration options
#
# Copyright (c) 2016 Wind River Systems, Inc.
#
# SPDX-License-Identifier: Apache-2.0
#

menuconfig USB_DEVICE
	bool "USB DEVICE"
	select USB_DEVICE_STACK
	default n
	help
	  Enable USB device drivers.

menuconfig USB_HOST
	bool "USB HOST"
	select USB_HOST_STACK
	default n
	help
	  Enable USB host drivers.

source "drivers/usb/otg/Kconfig"
```

## ext/actions/att/Kconfig
```kconfig
# Kconfig - ACTIONS primitive options for sdk version 2.0

#
# Copyright (c) 2015 Intel Corporation
#
# Licensed under the Apache License, Version 2.0 (the "License");
# you may not use this file except in compliance with the License.
# You may obtain a copy of the License at
#
#     http://www.apache.org/licenses/LICENSE-2.0
#
# Unless required by applicable law or agreed to in writing, software
# distributed under the License is distributed on an "AS IS" BASIS,
# WITHOUT WARRANTIES OR CONDITIONS OF ANY KIND, either express or implied.
# See the License for the specific language governing permissions and
# limitations under the License.
#

menu "ACTIONS ATT Configuration"

config ACTIONS_ATT
    bool
    prompt "ACTIONS auto test"
    default n
    help
    This option ACTIONS auto test	

config ATT_CYCLIC_TEST
    bool
    prompt "ACTIONS auto cyclic test"
    depends on ACTIONS_ATT
    default n
    help
    This option ACTIONS auto cyclic test	

config ATT_CHANNEL_AUXFD
    bool
    prompt "auto test channel aux select auxfd"
    depends on ACTIONS_ATT
    default n
    help
    This option auto test channel aux select auxfd	    

config ATT_USB_STUB
    bool
    prompt "ACTION_ATT use usb_stub"
    depends on ACTIONS_ATT
    default n
    help
    This option enable ACTIONS_ATT use usb_stub.
endmenu
```

## ext/actions/base/Kconfig
```kconfig
#
# Copyright (c) 2020 Actions Semiconductor
#
# SPDX-License-Identifier: LicenseRef-BSD-5-Clause-Actions
#

menu "Actions framework"

config ACTIONS_FRAMEWORK
	bool
	prompt "actions framework"
	default n
	select LEGACY_TIMEOUT_API
	help
	This option enable or disable actions framework

source "ext/actions/base/core/Kconfig"
source "ext/actions/base/utils/Kconfig"
source "ext/actions/base/property/Kconfig"
source "ext/actions/base/memory/Kconfig"
endmenu
```

## ext/actions/base/utils/img_load/Kconfig
```kconfig
# Kconfig - ACTIONS primitive options for sdk version 2.0

#
# Copyright (c) 2023 Actions Semiconductor Co., Ltd
# PDX-License-Identifier: Apache-2.0
#

menu "Image load Configuration"

config ACTIONS_IMG_LOAD
    bool
    prompt "ACTIONS image load"
    default n

config ACTIONS_IMG_FCC
    bool
    prompt "ACTIONS FCC test"
    default n
    help
        This option ACTIONS FCC test

config ACTIONS_IMG_RF_NS
    bool
    prompt "ACTIONS RF no signaling mode"
    default n

config ACTIONS_IMG_TEST_ALWAYS
    bool
    prompt "ACTIONS imagine test always or not"
    default n
endmenu
```

## ext/actions/bluetooth/bt_stack/Kconfig.ascs
```kconfig
# Bluetooth Audio - Audio Stream Control Service options
#
# Copyright (c) 2021 Actions Corporation
#
# SPDX-License-Identifier: Apache-2.0
#

if BT_AUDIO

config BT_ASCS
	bool "Audio Stream Control Service Support"
	default n
	help
	  This option enables support for Audio Stream Control Service.

if BT_ASCS

config BT_ASCS_BUF_SIZE
	int "Buffer size of each ASCS instance"
	default 256
	help
	  Sets the buffer size of Audio Stream Control Service (ASCS)
	  instance.

config BT_ASCS_RSP_SIZE
	int "Buffer size of each ASCS instance for response"
	default 32
	help
	  Sets the buffer size of Audio Stream Control Service (ASCS)
	  instance for response.

config BT_DEBUG_ASCS
	bool "Audio Stream Control Service debug"
	depends on BT_AUDIO_DEBUG
	help
	  Use this option to enable Audio Stream Control Service
	  debug logs for the Bluetooth Audio functionality.

endif # BT_ASCS

config BT_ASCS_CLIENT
	bool "Audio Stream Control Profile Support"
	select BT_GATT_CLIENT
	default n
	help
	  This option enables support for Audio Stream Control Profile.

if BT_ASCS_CLIENT

config BT_ASCS_CLIENT_BUF_SIZE
	int "Buffer size of each ASCS Client"
	default 256
	help
	  Sets the buffer size of Audio Stream (ASCS) Client.

config BT_DEBUG_ASCS_CLIENT
	bool "Audio Stream Control Service client debug"
	depends on BT_AUDIO_DEBUG
	help
	  Use this option to enable Audio Stream Control Service client
	  debug logs for the Bluetooth Audio functionality.

endif # BT_ASCS_CLIENT

endif # BT_AUDIO
```

## ext/actions/bluetooth/bt_stack/Kconfig.buf
```kconfig
# Kconfig - net stack configuration options

#
# Copyright (c) 2015 Intel Corporation
#
# SPDX-License-Identifier: Apache-2.0
#

if ACTS_NET_BUF

config NET_BUF_USER_DATA_SIZE
	int "Size of user_data reserved"
	default 4
	help
	This is for drivers to set how much user_data shall be included in
	each network data fragment.
	Example: For Bluetooth, the user_data shall be at least 4 bytes as
	that is used for identifying the type of data they are carrying.

config NET_BUF_LOG
	bool "Network buffer logging"
	select STDOUT_CONSOLE
	select SYS_LOG
	default n
	help
	Enable logs and checks for the generic network buffers.

config SYS_LOG_NET_BUF_LEVEL
	int
	prompt "Network buffer Logging level"
	depends on NET_BUF_LOG && SYS_LOG
	default 1
	range 0 4
	help
	  Sets log level for network buffers.
	  Levels are:
	  0 OFF, do not write
	  1 ERROR, only write SYS_LOG_ERR
	  2 WARNING, write SYS_LOG_WRN in addition to previous level
	  3 INFO, write SYS_LOG_INF in addition to previous levels
	  4 DEBUG, write SYS_LOG_DBG in addition to previous levels

config NET_BUF_WARN_ALLOC_INTERVAL
	int
	prompt "Interval of Network buffer allocation warnings"
	depends on NET_BUF_LOG
	default 1
	range 0 60
	help
	Interval in seconds of Network buffer allocation warnings which are
	generated when a buffer cannot immediately be allocated with K_FOREVER
	which may lead to deadlocks. Setting it to 0 makes warnings to be
	printed only once per allocation.

config NET_BUF_SIMPLE_LOG
	bool "Network buffer memory debugging"
	depends on NET_BUF_LOG
	select STDOUT_CONSOLE
	select SYS_LOG
	default n
	help
	  Enable extra debug logs and checks for the generic network buffers.

config NET_BUF_POOL_USAGE
	bool "Network buffer pool usage tracking"
	default n
	help
	Enable network buffer pool tracking. This means that:
	* amount of free buffers in the pool is remembered
	* total size of the pool is calculated
	* pool name is stored and can be shown in debugging prints

endif
```

## ext/actions/bluetooth/bt_stack/Kconfig.cas
```kconfig
# Bluetooth Audio - Coordinated Set Identification Service options
#
# Copyright (c) 2021 Actions Corporation
#
# SPDX-License-Identifier: Apache-2.0
#

if BT_AUDIO

config BT_CAS
	bool "Common Audio Service Support"
	select BT_CSIS
	default n
	help
	  This option enables support for Common Audio Service.

config BT_CAS_CLIENT
	bool "Common Audio Profile Support"
	select BT_CSIS_CLIENT
	default n
	help
	  This option enables support for Common Audio Profile.

if BT_CAS_CLIENT

config BT_DEBUG_CAS_CLIENT
	bool "Common Audio Service client debug"
	depends on BT_AUDIO_DEBUG
	help
	  Use this option to enable Common Audio Service client
	  debug logs for the Bluetooth Audio functionality.

endif # BT_CAS_CLIENT

endif # BT_AUDIO
```

## ext/actions/bluetooth/bt_stack/Kconfig.csis
```kconfig
# Bluetooth Audio - Coordinated Set Identification Service options
#
# Copyright (c) 2021 Actions Corporation
#
# SPDX-License-Identifier: Apache-2.0
#

if BT_AUDIO

config BT_CSIS
	bool "Coordinated Set Identification Service Support"
	default n
	help
	  This option enables support for Coordinated Set Identification Service.

if BT_CSIS

config BT_CSIS_TEST_SAMPLE_DATA
	bool "Coordinated Set Identification Service Test Sample Data"
	help
	  Enable the use of the sample data defined by the CSIS spec SIRK.
	  This will use the sample SIRK, prand and LTK.

	  WARNING: This option enables anyone to track and decrypt the SIRK
	  (if encrypted) using public sample data.
	  Should not be used for production builds.

config BT_DEBUG_CSIS
	bool "Coordinated Set Identification Service debug"
	depends on BT_AUDIO_DEBUG
	help
	  Use this option to enable Coordinated Set Identification Service debug
	  logs for the Bluetooth Audio functionality.

endif # BT_CSIS

config BT_CSIS_CLIENT
	bool "Coordinated Set Identification Profile Support"
	select BT_GATT_CLIENT
	default n
	help
	  This option enables support for Coordinated Set Identification Profile.

if BT_CSIS_CLIENT

config BT_DEBUG_CSIS_CLIENT
	bool "Coordinated Set Identification Service client debug"
	depends on BT_AUDIO_DEBUG
	help
	  Use this option to enable Coordinated Set Identification Service client
	  debug logs for the Bluetooth Audio functionality.

endif # BT_CSIS_CLIENT

config BT_DEBUG_CSIS_CRYPTO
	bool "Coordinated Set Identification Service crypto functions debug"
	depends on BT_CSIS_CLIENT || BT_CSIS
	help
	  Use this option to enable Coordinated Set Identification Service
	  crypto functions debug logs for the Bluetooth Audio functionality.

endif # BT_AUDIO
```

## ext/actions/bluetooth/bt_stack/Kconfig.gmas
```kconfig
# Bluetooth Audio - Gaming Audio Service options
#
# Copyright (c) 2024 Actions Corporation
#
# SPDX-License-Identifier: Apache-2.0
#

if BT_AUDIO

config BT_GMAS
	bool "Gaming Audio Service Support"
	default y
	help
	  This option enables support for Gaming Audio Service.

config BT_DEBUG_GMAS
	bool
	depends on BT_GMAS
	default n

config BT_GMAS_CLIENT
	bool "Gaming Audio Profile Support"
	select BT_GATT_CLIENT
	default y
	help
	  This option enables support for Gaming Audio Profile.

config BT_DEBUG_GMAS_CLIENT
	bool
	depends on BT_GMAS_CLIENT
	default n

endif # BT_AUDIO
```
