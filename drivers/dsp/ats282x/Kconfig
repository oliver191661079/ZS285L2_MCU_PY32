## drivers/dsp/ats282x/Kconfig
```kconfig
# Kconfig - DSP device configuration options
#
#
# Copyright (c) 2018 Actions Semiconductor Co., Ltd
#
# SPDX-License-Identifier: Apache-2.0
#

#
# DSP options
#
menuconfig DSP
	bool
	prompt "DSP driver Configuration"
	default n

if DSP
config DSP_0_DEV_NAME
	string "Device name for DSP Controller 0"
	default "DSP_0"
	help
	Device name for DSP Controller 0.

config DSP_0_IRQ_PRI
	int "IRQ Priority for DSP Controller 0"
	default 0
	help
	IRQ Priority for the DSP Controller.

endif # DSP
```

## drivers/fm/Kconfig
```kconfig
# Kconfig - fm drivers

#
# Copyright (c) 2017 Intel Corporation
#
# SPDX-License-Identifier: Apache-2.0
#

config FM
	bool "actions fm module support"
	depends on I2C
	default n
	help
	  enanle actions fm module

config FM_DEV_NAME
	string
	prompt "FM device name"
	depends on FM
	default "FM"

config FM_TRANSMITTER
	bool "actions fm transmitter support"
	depends on FM
	default n
	help
	 enable actions fm transmitter

config FM_QN8027
	bool "fm qn8027 module support"
	depends on FM_TRANSMITTER
	default n
	help
	  enable actions fm qn8027

config FM_EXT_24M
	bool "fm used ext clock"
	depends on FM_TRANSMITTER
	default n
	help
	  enable used ext clock

config FM_RECEIVER
	bool "actions fm receiver support"
	depends on FM
	default n
	help
	  enable actions fm receiver

config FM_QN8035
	bool "fm qn8035 module support"
	depends on FM_RECEIVER
	default n
	help
	  enable actions fm qn8035

config FM_RDA5820
	bool "fm rda5820 module support"
	depends on FM
	default n
	help
	  enable actions fm rda5820
```

## drivers/gpio/Kconfig.acts
```kconfig
# Kconfig - GPIO driver configuration options

#
# Copyright (c) 2018 Actions Semiconductor Co., Ltd
# 
# SPDX-License-Identifier: Apache-2.0
#

menuconfig GPIO_ACTS
	bool "Actions SoC GPIO driver"
	depends on GPIO && SOC_FAMILY_ACTS
	default y
	help
	 Enable support for the Actions SoC GPIO driver.

if GPIO_ACTS

config GPIO_ACTS_DEV_NAME
	string
	prompt "GPIO device name"
	depends on GPIO_ACTS
	default "GPIO_0"

config GPIO_ACTS_IRQ_PRI
	int "GPIO interrupt priority"
	default 1

config GPIO_ACTS_INIT_PRIORITY
	int
	default 20
	prompt "GPIO init priority"
	help
	  Device driver initialization priority.

endif # GPIO_ACTS

menuconfig GPIO_WIO_ACTS
	bool "Actions SoC Wakeup GPIO driver"
	depends on GPIO && SOC_FAMILY_ACTS
	default y
	help
	 Enable support for the Actions SoC Wakeup GPIO driver.

if GPIO_WIO_ACTS

config GPIO_WIO_ACTS_DEV_NAME
	string
	prompt "WIO device name"
	depends on GPIO_WIO_ACTS
	default "WIO"

endif # GPIO_WIO_ACTS
```

## drivers/i2c/Kconfig.slave
```kconfig
# Kconfig - I2C Slave configuration options

#
# Copyright (c) 2018 Actions Semiconductor Co., Ltd
#
# SPDX-License-Identifier: Apache-2.0
#

#
# I2C Slave options
#
menuconfig I2C_SLAVE
	bool
	prompt "I2C Slave Drivers"
	default n
	help
	  Enable I2C Slave Driver Configuration

if I2C_SLAVE

config I2C_SLAVE_INIT_PRIORITY
	int
	default 60
	prompt "Init priority"
	help
	  I2C slave device driver initialization priority.

config SYS_LOG_I2C_SLAVE_LEVEL
	int
	prompt "I2C slave log level"
	depends on SYS_LOG
	default 0
	help
	  Sets log level for I2C slave drivers.
	  Levels are:
	  - 0 OFF, do not write
	  - 1 ERROR, only write SYS_LOG_ERR
	  - 2 WARNING, write SYS_LOG_WRN in addition to previous level
	  - 3 INFO, write SYS_LOG_INF in addition to previous levels
	  - 4 DEBUG, write SYS_LOG_DBG in addition to previous levels

config I2C_SLAVE_0
	bool "Enable I2C Slave Port 0"
	depends on !I2C_0
	default n

config I2C_SLAVE_0_NAME
	string "Port 0 device name"
	depends on I2C_SLAVE_0 && !HAS_DTS_I2C
	default "I2C_SLAVE_0"

config I2C_SLAVE_0_IRQ_PRI
	int "Port 0 interrupt priority"
	depends on I2C_SLAVE_0 && !HAS_DTS_I2C
	default 0
	help
	  IRQ priority.

config I2C_SLAVE_0_RX_BUF_SIZE
	int "Port 0 RX buffer size"
	depends on I2C_SLAVE_0 && !HAS_DTS_I2C
	default 64
	help
	  RX buffer size.

config I2C_SLAVE_0_TX_BUF_SIZE
	int "Port 0 TX buffer size"
	depends on I2C_SLAVE_0 && !HAS_DTS_I2C
	default 64
	help
	  TX buffer size.

config  I2C_SLAVE_0_SDA_PIN
	int "i2c slave 0 sda pin"
	depends on I2C_SLAVE_0 && !HAS_DTS_I2C
	default 1
	help
	  i2c slave 0 sda pin number.

config  I2C_SLAVE_0_SCL_PIN
	int "i2c slave 0 scl pin"
	default 0
	depends on I2C_SLAVE_0 && !HAS_DTS_I2C
	help
	  i2c slave 0 scl pin number.





config I2C_SLAVE_1
	bool "Enable I2C Slave Port 1"
	depends on !I2C_1
	default n

config I2C_SLAVE_1_NAME
	string "Port 1 device name"
	default "I2C_SLAVE_1"
	depends on I2C_SLAVE_1 && !HAS_DTS_I2C

config I2C_SLAVE_1_IRQ_PRI
	int "Port 1 interrupt priority"
	depends on I2C_SLAVE_1 && !HAS_DTS_I2C
	default 0
	help
	  IRQ priority.

config I2C_SLAVE_1_RX_BUF_SIZE
	int "Port 1 RX buffer size"
	depends on I2C_SLAVE_1 && !HAS_DTS_I2C
	default 64
	help
	  RX buffer size.

config I2C_SLAVE_1_TX_BUF_SIZE
	int "Port 1 TX buffer size"
	depends on I2C_SLAVE_1 && !HAS_DTS_I2C
	default 64
	help
	  TX buffer size.

config I2C_SLAVE_ACTS
	bool "Actions SoC I2C support"
	depends on I2C_SLAVE && SOC_FAMILY_ACTS
	default n
	help
	  Enable Actions SoC I2C slave support on the selected board

endif # I2C SLAVE
```

## drivers/input/Kconfig
```kconfig
# Kconfig - Input device configuration options
#
#
# Copyright (c) 2017 Actions Semiconductor Co., Ltd
#
# SPDX-License-Identifier: Apache-2.0
#

menuconfig INPUT_DEV
	bool
	prompt "Input device drivers"
	default n
	help
	  Enable input device driver configuration

if INPUT_DEV
config SYS_LOG_INPUT_DEV_LEVEL
	int
	prompt "INPUT Device drivers log level"
	depends on SYS_LOG
	range 0 4
	default 0
	help
	  Sets log level for INPUT Device driver.

	  Levels are:
	  - 0 OFF, do not write
	  - 1 ERROR, only write SYS_LOG_ERR
	  - 2 WARNING, write SYS_LOG_WRN in addition to previous level
	  - 3 INFO, write SYS_LOG_INF in addition to previous levels
	  - 4 DEBUG, write SYS_LOG_DBG in addition to previous levels

config INPUT_DEV_ACTS_ADCKEY
	bool "Actions SoC adc keypad driver"
	depends on SOC_FAMILY_ACTS
	default n
	help
	  Enable support for Actions SoC adc keypad driver.

config INPUT_DEV_ACTS_ADCKEY_NAME
	string "Device Name for Actions SoC adc keypad"
	depends on INPUT_DEV_ACTS_ADCKEY
	default "adckey"
	help
	  Device name for Actions SoC ADC keypad.

config INPUT_DEV_ACTS_ADCKEY_ADC_NAME
	string "Device Name for Actions SoC adc keypad"
	depends on INPUT_DEV_ACTS_ADCKEY
	default "ADC_0"
	help
	  ADC device name for Actions SoC ADC keypad.

config INPUT_DEV_ACTS_ADCKEY_ADC_CHAN
	int "Device Name for Actions SoC adc keypad"
	depends on INPUT_DEV_ACTS_ADCKEY
	help
	  ADC channel number for Actions SoC ADC keypad.

config INPUT_DEV_ACTS_GPIOKEY
	bool "Actions SoC gpio keypad driver"
	depends on INPUT_DEV_ACTS_ADCKEY
	default n
	help
		Enable support for Actions SoC gpio keypad driver.

config INPUT_DEV_ACTS_GPIOKEY_PULLUP_BY_INNER
	bool "Actions SoC gpio keypad driver gpio pull up by inner"
	depends on INPUT_DEV_ACTS_GPIOKEY
	default n
	help
		Enable support for Actions SoC gpio keypad driver pull up by inner.

config INPUT_DEV_ACTS_GPIOKEY_ONLY
	bool "Actions SoC gpio keypad driver gpio only without adckey"
	depends on INPUT_DEV_ACTS_GPIOKEY
	default n
	help
		Enable support for Actions SoC gpio keypad  only without adckey.

config INPUT_DEV_ACTS_ONOFF_KEY
	bool "Actions SoC On/Off key driver"
	depends on SOC_FAMILY_ACTS
	default n
	help
	  Enable support for Actions SoC On/Off key driver.

config INPUT_DEV_ACTS_ONOFF_KEY_NAME
	string "Device Name for Actions SoC On/Off key keyboard"
	default "onoff_key"
	depends on INPUT_DEV_ACTS_ONOFF_KEY
	help
	  Device name for Actions SoC On/Off key keyboard.

config INPUT_DEV_ACTS_TOUCH_KEY
	bool "Actions SoC Touch key driver"
	depends on SOC_FAMILY_ACTS
	default n
	help
	  Enable support for Actions SoC On/Off key driver.

config INPUT_DEV_ACTS_TOUCH_KEY_NAME
	string "Device Name for Actions SoC Touch key keyboard"
	default "touch_key"
	depends on INPUT_DEV_ACTS_TOUCH_KEY
	help
	  Device name for Actions SoC On/Off key keyboard.

config INPUT_DEV_ACTS_IRKEY
	bool "Actions SoC infrared keypad driver"
	depends on SOC_FAMILY_ACTS
	default n
	help
	  Enable support for Actions SoC adc keypad driver.

config INPUT_DEV_ACTS_IRKEY_NAME
	string "Device Name for Actions SoC infrared keypad"
	depends on INPUT_DEV_ACTS_IRKEY
	default "irkey"
	help
	  Device name for Actions SoC infrared keypad.

config INPUT_DEV_ACTS_ADC_SR
	bool "Actions SoC adc SR(Sliding rheostat) driver"
	depends on SOC_FAMILY_ACTS
	default n
	help
	  Enable support for Actions SoC adc SR driver.

config INPUT_DEV_ACTS_ADC_SR_NAME
	string "Device Name for Actions SoC adc keypad"
	depends on INPUT_DEV_ACTS_ADC_SR
	default "adcsr_drv"
	help
	  Device name for Actions SoC adc SR.

config INPUT_DEV_ACTS_SR_ADC_NAME
	string "ADC Device Name for Actions SoC adc SR"
	depends on INPUT_DEV_ACTS_ADC_SR
	default "ADC_0"
	help
	  ADC device name for Actions SoC ADC SR.

config INPUT_DEV_ACTS_SR_ADC_CHAN
	int "ADC channel number for Actions SoC ADC SR"
	depends on INPUT_DEV_ACTS_ADC_SR
	help
	  ADC channel number for Actions SoC ADC SR.
endif # INPUT_DEV
```

## drivers/logic_mcu_ls8a10023t/Kconfig
```kconfig
menu "Logic mcu : LS8A10023T Drivers"

config LOGIC_MCU_LS8A10023T_DEV_NAME
	string
	prompt "LOGIC MCU LS8A10023T DEV NAME"
	default "LOGIC MCU LS8A10023T DEV NAME"

config LOGIC_MCU_LS8A10023T
	bool "LOGIC MCU LS8A10023T driver"
	default n
	help
		Enable/Disable LOGIC MCU LS8A10023T

endmenu
```

## drivers/mpu/Kconfig
```kconfig
# Kconfig - DSP device configuration options
#
#
# Copyright (c) 2018 Actions Semiconductor Co., Ltd
#
# SPDX-License-Identifier: Apache-2.0
#

#
# MPU options
#

config MPU_ACTS
	bool "Memory protect unit for Actions SoC"
	default n
	help
	enable actions mpu
	
choice
    prompt "mpu driven select"
    default MPU_EXCEPTION_DRIVEN
    help
      Select mpu driven 
	
config MPU_MPU_IRQ_DRIVEN
    bool    
    prompt "use mpu interrupt driven"
    depends on MPU_ACTS
    help
    This option select mpu driven type
    
config MPU_EXCEPTION_DRIVEN
    bool    
    prompt "use mpu exception driven"
    depends on MPU_ACTS
    help
    This option select mpu driven type    	
endchoice


choice
    prompt "mpu index 0 select"
    default MPU_MONITOR_RAMFUNC_WRITE
    help
      Select mpu index0 use 
      	
config MPU_MONITOR_BTC_MEMORY
    bool    
    prompt "use mpu monitor bt controller memory"
    depends on MPU_ACTS
    help
    This option enables mpu monitor bt controller memory 	


config MPU_MONITOR_CACHECODE_WRITE
    bool    
    prompt "use mpu monitor cache code write"
    depends on MPU_ACTS
    help
    This option enables mpu monitor cache code write  
    
config MPU_MONITOR_RAMFUNC_WRITE
    bool    
    prompt "use mpu monitor ramfunc write"
    depends on MPU_ACTS
    help
    This option enables mpu monitor ramfunc write     
endchoice

choice
    prompt "mpu index 1 select"
    default MPU_MONITOR_USER_DATA
    help
      Select mpu index1 use 
    
config MPU_MONITOR_DSP_WRITE_MCU_MEMORY
    bool    
    prompt "use mpu monitor dsp write mcu memory"
    depends on MPU_ACTS
    help
    This option enables mpu monitor dsp write mcu memory  

config MPU_MONITOR_USER_DATA
    bool    
    prompt "use mpu monitor user data"
    depends on MPU_ACTS
    help
    This option enables mpu monitor dsp write mcu memory 
endchoice
           
config MPU_MONITOR_ROMFUNC_WRITE
    bool    
    prompt "use mpu monitor rom func write"
    depends on MPU_ACTS
    default y
    help
    This option enables mpu monitor rom func write 
    
config MPU_MONITOR_STACK_OVERFLOW
    bool    
    prompt "use mpu monitor stack overflow"
    depends on MPU_ACTS
    default y
    help
    This option enables mpu monitor rom func write
    
config MPU_ACTS_MAX_INDEX
    int    
    prompt "mpu max entry index"
    depends on MPU_ACTS
    default 4
    help
    This option select mpu monitor bt controller memory index     
    
config MPU_MONITOR_BTC_MEMORY_INDEX
    int    
    prompt "use mpu monitor bt controller memory index"
    depends on MPU_MONITOR_BTC_MEMORY
    default 0
    help
    This option select mpu monitor bt controller memory index    

config MPU_MONITOR_CACHECODE_WRITE_INDEX
    int    
    prompt "use mpu monitor cache code write index"
    depends on MPU_MONITOR_CACHECODE_WRITE
    default 0
    help
    This option select mpu monitor cache code write index 
    
config MPU_MONITOR_RAMFUNC_WRITE_INDEX
    int    
    prompt "use mpu monitor ramfunc write"
    depends on MPU_MONITOR_RAMFUNC_WRITE
    default 0
    help
    This option select mpu monitor ramfunc write index
    
config MPU_MONITOR_DSP_WRITE_MCU_MEMORY_INDEX
    int    
    prompt "use mpu monitor dsp write mcu memory index"
    depends on MPU_ACTS
    default 1
    help
    This option select mpu monitor dsp write mcu memory index  
    
config MPU_MONITOR_USER_DATA_INDEX
    int    
    prompt "use mpu monitor user data memory index"
    depends on MPU_ACTS
    default 1
    help
    This option select mpu monitor user data memory index    
    
config MPU_MONITOR_ROMFUNC_WRITE_INDEX
    int    
    prompt "use mpu monitor rom func write index"
    depends on MPU_MONITOR_ROMFUNC_WRITE
    default 2
    help
    This option select mpu monitor rom func write index
       
config MPU_MONITOR_STACK_OVERFLOW_INDEX
    int    
    prompt "use mpu monitor stack overflow index"
    depends on MPU_MONITOR_STACK_OVERFLOW
    default 3
    help
    This option select mpu monitor rom func write  
    
config MPU_CSKY
    bool
    default n
    help
    enable csky mpu 
    
config MPU_CSKY_MONITOR_ROMFUNC_WRITE
    bool    
    prompt "use csky mpu monitor rom func write"
    depends on MPU_CSKY
    default n
    help
    This option enables mpu monitor rom func write 
       
    
config MPU_CSKY_MONITOR_CACHEREGION_WRITE
    bool    
    prompt "use csky mpu monitor cache region write"
    depends on MPU_CSKY
    default n
    help
    This option enables mpu monitor rom func write
                                              
```

## drivers/pa_tas2780/Kconfig
```kconfig
menu "PA_TAS2780 Drivers"

config PA_TAS2780_DEV_NAME
	string
	prompt "PA TAS2780 DEV NAME"
	default "PA TAS2780 DEV NAME"

config PA_TAS2780
	bool "PA TAS2780 driver"
	default n
	help
		Enable/Disable PA TAS2780 amplifier

endmenu
```

## drivers/pwm/Kconfig.acts
```kconfig
# Kconfig - Actions SoC PWM configuration options
#
#
# Copyright (c) 2018 Actions Semiconductor Co., Ltd
#
# SPDX-License-Identifier: Apache-2.0
#

menuconfig PWM_ACTS
	bool "Actions SoC PWM driver"
	depends on PWM
	default n
	help
	  This option enables the PWM driver for Actions SoC.
	  Say y if you wish to use PWM port on Actions SoC.

if PWM_ACTS

config PWM_ACTS_DEV_NAME
	string "Actions SoC PWM Device Name"
	depends on PWM_ACTS
	default "PWM_0"
	help
	  Specify the device name for the Actions SoC PWM driver.

config PWM_CLK_SRC
	int "PWMs clock source selection"
	depends on PWM_ACTS
	default 0
	range 0 2
	help
	  Set clock source of PWMs for Actions Soc.
	    - 0: RC32K
		- 1: HOSC
		- 2: CK64M

config PWM_CLK_DIV
	int "Set the divisor of PWMs clock source"
	depends on PWM_ACTS
	default 3
	range 0 260
	help
	  Set the divisor of PWMs clock source for Actions Soc.
	    - 0: /1
		- 1: /2
		- 255: 256
		- 256: 512
		- 257: 1024
		- 258: 2048
		- 259: 4096
		- 260: 8192

endif # PWM_ACTS
```
