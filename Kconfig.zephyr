## Kconfig.zephyr
```kconfig
# Kconfig - general configuration options

#
# Copyright (c) 2014-2015 Wind River Systems, Inc.
# Copyright (c) 2016 Intel Corporation
#
# SPDX-License-Identifier: Apache-2.0
#
config KERNELVERSION
	string
	option env="KERNELVERSION"

config APPLICATION_VAR_SYM
    string
    option env="APPLICATION"
source "arch/Kconfig"

source "kernel/Kconfig"

source "dts/Kconfig"

source "drivers/Kconfig"

source "net/Kconfig"

source "misc/Kconfig"

source "lib/Kconfig"

source "subsys/Kconfig"

source "ext/Kconfig"

source "tests/Kconfig"

#source "samples/storyapp/src/Kconfig"

source "samples/$APPLICATION_VAR_SYM/src/Kconfig"
#source "samples/bt_box/src/Kconfig"

#
# The following are for Kconfig files for default values only.
# These should be parsed at the end.
#
# Board defaults should be parsed after SoC defaults
# because board usually overrides SoC values.
#
source "arch/*/soc/*/Kconfig.defconfig"
source "boards/*/*/Kconfig.defconfig"
source "ext/actions/Kconfig.defconfig"
```

## arch/csky/Kconfig
```kconfig
#
# Copyright (c) 2014-2015 Wind River Systems, Inc.
#
# SPDX-License-Identifier: Apache-2.0
#

choice
	prompt "CSKY SoC Selection"
	depends on CSKY

	source "arch/csky/soc/*/Kconfig.soc"
endchoice

menu "CSKY Options"
	depends on CSKY

config ARCH
	default "csky"

config ARCH_DEFCONFIG
	string
	default "arch/csky/defconfig"


source "arch/csky/core/Kconfig"

menu "Board Configuration"

source "arch/csky/soc/*/Kconfig"

endmenu
endmenu
```

## arch/csky/core/Kconfig
```kconfig
#
# Copyright (c) 2015 Wind River Systems, Inc.
#
# SPDX-License-Identifier: Apache-2.0
#

config CPU_CSKYV2L
	bool
	default y
	select ARCH_HAS_CUSTOM_SWAP_TO_MAIN
	select ATOMIC_OPERATIONS_C
	select HAS_FLASH_LOAD_OFFSET
	select HAS_CSKY_CSI
#	select CSKY_CORETIM
    select ARCH_SUPPORTS_COREDUMP

config CPU_CK802
	bool
	default y

config CPU_CK803S
	bool
	default n

config CSKY_CORETIM
	default y

config CSKY_CORETIM_IRQNUM
	int "coretim irq number"
	depends on CSKY_CORETIM

config CPU_HAS_SYSTICK
	bool
	# Omit prompt to signify "hidden" option
	default n
	help
	This option is enabled when the CPU has systick timer implemented.

config CPU_HAS_FPU
	# Hidden config selected by CPU family
	bool
	default n
	help
	This option is enabled when the CPU has a hardware floating point
	unit.

config IRQ_OFFLOAD
	bool "Enable IRQ offload"
	default n
	help
	Enable irq_offload() API which allows functions to be synchronously
	run in interrupt context. Adds some overhead to context switching.
	Mainly useful for test cases.

config IRQ_STAT
	bool "Collect IRQ statistics"
	depends on GEN_SW_ISR_TABLE
	default n
	help
	 Collect IRQ statistics, such as IRQ count, the maximum running cycles of IRQ.

config DISABLE_IRQ_STAT
    bool "monitor IRQ disable time"
    default y
    help
     monitor IRQ disable time

config IRQ_LATENCY_STAT
    bool "monitor IRQ latency time"
    default n
    help
     monitor IRQ latency time

config IRQ_LATENCY_STAT_TIME_US
    int "monitor IRQ latency time value"
    default 24000
	depends on IRQ_LATENCY_STAT
    help
     monitor IRQ latency time value

config DISABLE_IRQ_US
    int "max IRQ disable time"
    default 1000
    help
     monitor IRQ disable time

config MONITOR_IRQ_STACKSIZE
    bool "monitor irq stack overflow"
    default y
    help
     monitor IRQ stack overflow or not

config MONITOR_IRQ_MIN_FREESIZE
    int "min irq stack freesize"
    default 64
    help
     min irq stack freesize

config XIP
	default n if CPU_CSKYV2L

config STACK_BACKTRACE
	bool "Enable stack backtrace"
	depends on CPU_CSKYV2L
	default n
	select THREAD_STACK_INFO
	help
	  Support dump stack backtrace by kallsyms.

	  If you say Y here the resulting kernel image will be slightly larger
	  but not slower, and it will give very useful debugging information.
	  If you don't debug the kernel, you can say N, but we may not be able
	  to solve problems without frame unwind information

config STACK_BACKTRACE_SYMNAME
	bool "Enable stack backtrace symbol name"
	depends on CPU_CSKYV2L
	default n
	select THREAD_STACK_INFO
	help
	  Support dump stack backtrace symbol name by kallsyms.

config ENABLE_TRACE_EVTTOSTR
    bool "backtrace enable event to string"
    default n
    help
        Backtrace enable event to string or not.

config SWAP_TSPEND
    bool "Enable thread switch use tspend IRQ"
    depends on CPU_CSKYV2L
    default y
    help
       Support thread switch use tspend IRQ

config SWAP_TSPEND_CHECK
    bool "Check tspend status in thread swap"
    depends on SWAP_TSPEND
    default y
    help
       Check tspend status after thread swap to ensure tspend IRQ is processed.

config GEN_ISR_TABLES
    default y

config IRQ_PRIO_HIGHEST
    int
    depends on CPU_CSKYV2L
    default 0
    help
       IRQ priority highest

config IRQ_PRIO_HIGH
    int
    depends on CPU_CSKYV2L
    default 1
    help
       IRQ priority high

config IRQ_PRIO_NORMAL
    int
    depends on CPU_CSKYV2L
    default 2
    help
       IRQ priority normal

config IRQ_PRIO_LOW
    int
    depends on CPU_CSKYV2L
    default 3
    help
       IRQ priority low

config SEPARATE_IRQ_SP
    bool
    depends on CPU_CSKYV2L
    default n
    help
        set hardware separate interrupt sp

config SYS_IRQ_LOCK
    bool "Lock irq by VIC interface"
    depends on CPU_CSKYV2L
    default n
    help
      Lock irq by VIC interface. Some special IRQ (e.g. bluetooth controller)
      still can be proccessed when using sys irq lock.

config SYS_IRQ_LOCK_EXCEPT_BT_CON
    bool "Lock irq except bluetooth controller IRQ"
    depends on SYS_IRQ_LOCK
    default n
    help
      Lock irq except bluetooth controller IRQ.

menu "Floating Point Options"
depends on CPU_HAS_FPU

config	FLOAT
	bool
	prompt "Floating point registers"
	default n
	help
	This option allows tasks and fibers to use the floating point registers.
	By default, only a single task or fiber may use the registers.

	Disabling this option means that any task or fiber that uses a
	floating point register will get a fatal exception.

endmenu
```

## arch/csky/defconfig
```kconfig
CONFIG_CSKY=y
CONFIG_SYS_CLOCK_HW_CYCLES_PER_SEC=24000000
CONFIG_CONSOLE=y
CONFIG_UART_CONSOLE=y
CONFIG_SERIAL=y
CONFIG_FLASH_SIZE=256
CONFIG_SRAM_SIZE=64
```

## arch/csky/soc/actions/Kconfig
```kconfig
# Kconfig - ST Microelectronics STM32 MCU line
#
# Copyright (c) 2016 Open-RnD Sp. z o.o.
#
# SPDX-License-Identifier: Apache-2.0
#

config SOC_FAMILY_ACTS
	bool
	# omit prompt to signify a "hidden" option
	default n

if SOC_FAMILY_ACTS
config SOC_FAMILY
	string
	default actions
endif

source "arch/csky/soc/actions/*/Kconfig.soc"
```

## arch/csky/soc/actions/andesc/Kconfig.defconfig.ats2831p
```kconfig
# Kconfig - Actions Bluetooth SoC platform configuration options

#
# Copyright (c) 2018 Actions Semiconductor Co., Ltd
#
# SPDX-License-Identifier: Apache-2.0
#

if SOC_ATS2831P

config SOC
	string
	default ats2831p


endif # SOC_ATS2831p
```

## arch/csky/soc/actions/andesc/Kconfig.defconfig.ats2835p
```kconfig
# Kconfig - Actions Bluetooth SoC platform configuration options

#
# Copyright (c) 2018 Actions Semiconductor Co., Ltd
#
# SPDX-License-Identifier: Apache-2.0
#

if SOC_ATS2835P

config SOC
	string
	default ats2835p


endif # SOC_ATS2835p
```

## arch/csky/soc/actions/andesc/Kconfig.defconfig.ats2835p2
```kconfig
# Kconfig - Actions Bluetooth SoC platform configuration options

#
# Copyright (c) 2018 Actions Semiconductor Co., Ltd
#
# SPDX-License-Identifier: Apache-2.0
#

if SOC_ATS2835P2

config SOC
	string
	default ats2835p2

config SOC_SERIES_ANDESC_P2
	bool "actions andesc P2 series"
	default y

endif # SOC_ATS2835p2
```

## arch/csky/soc/actions/andesc/Kconfig.defconfig.ats2875h
```kconfig
# Kconfig - Actions Bluetooth SoC platform configuration options

#
# Copyright (c) 2018 Actions Semiconductor Co., Ltd
#
# SPDX-License-Identifier: Apache-2.0
#

if SOC_ATS2875H

config SOC
	string
	default ats2875h

config SOC_SERIES_ANDESC_P2
	bool "actions andesc P2 series"
	default y

endif # SOC_ATS2875H
```

## arch/csky/soc/actions/andesc/Kconfig.defconfig.series
```kconfig
# Kconfig - Actions Bluetooth SoC platform configuration options

#
# Copyright (c) 2018 Actions Semiconductor Co., Ltd
#
# SPDX-License-Identifier: Apache-2.0
#

if SOC_SERIES_ANDESC

config SOC_SERIES
	default andesc

config GEN_ISR_TABLES
	default y

config GEN_IRQ_VECTOR_TABLE
	default n

config ISR_STACK_SIZE
	default 1024

config IDLE_STACK_SIZE
	default 512

config EXTRA_EXCEPTION_INFO
	bool
	default y

config SRAM_BASE_ADDRESS
	hex
	default 0x40000

config SRAM_SIZE
	int
	default 368
config SRAM_END_ADDRESS
	hex
	default 0x9c000

config DSP_SRAM_BASE_ADDRESS
	hex
	default 0x40000

config DSP_SRAM_END_ADDRESS
	hex
	default 0x9c000

config FLASH_BASE_ADDRESS
	hex
	default 0x01000000

config FLASH_SIZE
	int "rom flash size (KB)"
	default 1200
	help
		config SOC rom flash size

config TEXT_SECTION_OFFSET
	default 0x400

config BOOTLOADER_SRAM_SIZE
	default 0

config XIP
	default y

config NUM_IRQS
	int
	default 42

config NUM_IRQ_PRIO_BITS
	int
	default 3

config SYS_CLOCK_TICKS_PER_SEC
	int
	default 100

config SYS_CLOCK_HW_CYCLES_PER_SEC
	int
	default 24000000

config SOC_CPU_CLK_FREQ
	default 140000

config SOC_DSP_CLK_FREQ
	default 180000

config SOC_VDD_VOLTAGE
	default 1100

config BUSY_WAIT_USES_ALTERNATE_CLOCK
	default y

config ROM_XSPI_WRITE_DATA_PATCH
	bool
	default y

config SOC_SECURE_BOOT
	bool
	prompt "sob secure boot Support"
	default n
	help
	Enable soc secure boot or not.

config CSKY_CORETIM
	default n

config ACTS_TIMER
	default y

if SOC_MAPPING_PSRAM
config SOC_MAPPING_PSRAM_ADDR
	default 0x02000000

config SOC_MAPPING_PSRAM_SIZE
	default 0x200000

endif #SOC_MAPPING_PSRAM

if ADC

config ADC_ACTS
	def_bool y

endif # ADC

if GPIO

config GPIO_ACTS
	def_bool y

endif # GPIO

if I2C

config I2C_ACTS
	def_bool y

endif # I2C

if PWM

config PWM_ACTS
	def_bool y

endif # PWM

config SPI
	def_bool n

if SPI

config SPI_ACTS
	def_bool y

config SPI_1_ACTS_DELAY_CHAIN
	default 6

endif # SPI

if XSPI_NOR_ACTS

config XSPI_NOR_ACTS_DELAY_CHAIN
	default 6

endif # XSPI_NOR_ACTS

if SERIAL

config UART_ACTS
	def_bool y

endif # SERIAL

if MMC_0

config MMC_0_DATA_REG_WIDTH
	default 4

endif # MMC_0

if MMC_1

config MMC_1_DATA_REG_WIDTH
	default 4

endif # MMC_1

source "arch/csky/soc/actions/andesc/Kconfig.defconfig.ats*"

endif # SOC_SERIES_ANDESC
```

## arch/csky/soc/actions/andesc/Kconfig.series
```kconfig
# Kconfig - Actions Bluetooth SoC configuration options

#
# Copyright (c) 2018 Actions Semiconductor Co., Ltd
#
# SPDX-License-Identifier: Apache-2.0
#

config  SOC_SERIES_ANDESC
	bool "Actions Andesc Bluetooth Series SoC"
	select SOC_FAMILY_ACTS
	help
	 Enable support for Actions Andesc Bluetooth Series SoC
```

## arch/csky/soc/actions/andesc/Kconfig.soc.ats2831p
```kconfig
# Kconfig - Actions Bluetooth SoC configuration options

#
# Copyright (c) 2018 Actions Semiconductor Co., Ltd
#
# SPDX-License-Identifier: Apache-2.0
#

config SOC_ATS2831P
	bool "ats2831p"
```

## arch/csky/soc/actions/andesc/Kconfig.soc.ats2835p
```kconfig
# Kconfig - Actions Bluetooth SoC configuration options

#
# Copyright (c) 2018 Actions Semiconductor Co., Ltd
#
# SPDX-License-Identifier: Apache-2.0
#

config SOC_ATS2835P
	bool "ats2835p"
```

## arch/csky/soc/actions/andesc/Kconfig.soc.ats2835p2
```kconfig
# Kconfig - Actions Bluetooth SoC configuration options

#
# Copyright (c) 2018 Actions Semiconductor Co., Ltd
#
# SPDX-License-Identifier: Apache-2.0
#

config SOC_ATS2835P2
	bool "ats2835p2"
```

## arch/csky/soc/actions/andesc/rom_config/Kconfig
```kconfig
# Kconfig - Actions Bluetooth SoC platform configuration options

#
# Copyright (c) 2018 Actions Semiconductor Co., Ltd
#
# SPDX-License-Identifier: Apache-2.0
#

if SOC_SERIES_ANDESC

config ROM_TABLE_ENTRY_ADDR
    int
    default 656

config USE_ROM_HRTIMER
    bool
    default n

config USE_ROM_THREAD_TIMER
    bool
    default y

config USE_ROM_VDMA
    bool
    default y

config USE_ROM_TIMER
    bool
    default y

config USE_ROM_TRACING
    bool
    default n

config USE_ROM_LIBC
    bool
    default y

config USE_ROM_CSB
    bool
    default y

config USE_ROM_SBC_CODEC
    bool
    default y

config USE_ROM_CSB_CODEC
    bool
    default y

config USE_ROM_CRC
    bool
    default y

config USE_ROM_LOG
    bool
    default y

config USE_ROM_CBUF
    bool
    default y

config USE_ROM_ACTS_RINGBUF
    bool
    default y

config USE_ROM_MALLOC
    bool
    default y

endif
```

## drivers/amp/Kconfig
```kconfig
# Kconfig - APM driver configuration options

#
# Copyright (c) 2023 Actions Semiconductor Co., Ltd
#
# SPDX-License-Identifier: Apache-2.0
#

menu "AMP Drivers"

config AMP_DEV_NAME
	string
	prompt "AMP device name"
	default "AMP"

config AMP_AW882XX
	bool "AW882XX driver"
	default n
	help
	  Enable/Disable AW88298 amplifier

endmenu
```

## drivers/audio/andes/shell/Kconfig
```kconfig
config AUDIODRV_SHELL
    bool "Enable audio driver shell support"
    default y
    help
      enable audio driver shell support

config AUDIODRV_TEST
    bool "Enable audio driver in and out test"
    default n
    depends on AUDIODRV_SHELL
    help
      If you say yes here, you will get suppport audio driver in and out test functions.
```

## drivers/bluetooth/hci/Kconfig.acts
```kconfig
# Copyright (c) 2018 Intel Corporation
# SPDX-License-Identifier: Apache-2.0


if BT_DRV

config BT_ACTIONS
	bool "Actions Virtual HCI"
	depends on BT_DRV
	help
	  Supports Actions ACTIONS bluetooth controller.
	  In which, Host and Controller are all residing in SOC,
	  they share messages using a virtual HCI.

 endif # BT_DRV
```
